## drivers/media/platform/kmb-camera/Kconfig
```kconfig
config VIDEO_INTEL_KEEMBAY_CAMERA
	tristate "INTEL Keem Bay camera subsystem"
	depends on VIDEO_V4L2 && VIDEO_V4L2_SUBDEV_API && HAS_DMA
	depends on XLINK_CORE && KEEMBAY_IPC && KEEMBAY_VPU_IPC
	select VIDEOBUF2_DMA_CONTIG
	select V4L2_FWNODE
	help
	  Driver for Keem Bay camera subsystem
```

## drivers/misc/Gpio-asm28xx/Kconfig
```kconfig
#
# kConfig for Asmedia 28xx/18xx GPIO driver
#

config GPIO_ASM_28XX
	tristate "Asmedia 28xx/18xx GPIO driver"
	default m
	help
	  Enable this option to get the THB emc in the IA host
```

## drivers/misc/emc2103/Kconfig
```kconfig
#
# kConfig for KeemBay Thermal Linux driver
#

config HOST_KMB_EMC
	tristate "IA Host Keembay emc Driver"
	default m
	help
	  Enable this option to get the KMB emc in the IA host
```

## drivers/misc/gna/Kconfig
```kconfig
# SPDX-License-Identifier: GPL-2.0-only
# Intel GMM & Neural Networks Accelerator device
#

config INTEL_GNA
        tristate "Intel GMM & Neural Networks Accelerator"
	depends on X86_64 && PCI
        help
	  This adds an option to enable the Intel GMM & Neural Networks Accelerator (Intel GNA)
	  driver. See Documentation/misc-devices/gna.rst for more information on the
	  functionality.

	  To compile this driver as a module, choose M here. The module
	  will be called gna.
```

## drivers/misc/hddl_device/Kconfig
```kconfig
# Copyright (C) 2020 Intel Corporation
# SPDX-License-Identifier: GPL-2.0-only

config HDDL_DEVICE_CLIENT
	tristate "Support for hddl device client"
	depends on XLINK_CORE && INTEL_TSENS_LOCAL_HOST
	help
	  This option enables HDDL device client module.

	  This driver is used for sharing time sync data to local host and
	  retrives the sensors available on the platform. This also handles
	  the device connect/disconnect programming sequence.
	  Say Y if using a processor that includes the Intel VPU such as
	  Keem Bay.  If unsure, say N.

config HDDL_DEVICE_SERVER
	tristate "Support for hddl device server"
	depends on XLINK_CORE && !HDDL_DEVICE_CLIENT
	help
	  This option enables HDDL device server module.

	  This driver is used for sharing time sync data to local host and
	  retrives the sensors available on the platform. This also handles
	  the device connect/disconnect programming sequence.
	  Say Y if using a processor that includes the Intel VPU such as
	  Keem Bay.  If unsure, say N.
```

## drivers/misc/host_kmb_tj/Kconfig
```kconfig
#
# kConfig for KeemBay Thermal Linux driver
#

config HOST_KMB_TJ
	tristate "IA Host Keembay Tj Driver"
	default m
	help
	  Enable this option to get the KMB Tj in the IA host
```

## drivers/misc/i3c_test/Kconfig
```kconfig
# SPDX-License-Identifier: GPL-2.0-only

config I3C_TEST
	tristate "KMB I3C test driver"
	default m
	depends on I3C
	select REGMAP_I3C
	help
		Keembay I3C test driver for introspect
```

## drivers/misc/intel_tsens/Kconfig
```kconfig
# Copyright (C) 2020 Intel Corporation
# SPDX-License-Identifier: GPL-2.0-only

config INTEL_TSENS_LOCAL_HOST
	bool "Temperature sensor driver for intel tsens"
	select THERMAL
	help
	  This option enables tsens thermal local Host driver.

	  This driver is used for reporting thermal data via thermal
	  framework.
	  Enable this option if you want to have support for thermal
	  management controller.
	  Say Y if using a processor that includes the Intel VPU such as
	  Keem Bay.  If unsure, say N.

config INTEL_TSENS_I2C_SLAVE
	bool "I2C slave driver for intel tsens"
	depends on INTEL_TSENS_LOCAL_HOST
	select I2C
	select I2C_SLAVE
	help
	  This option enables tsens i2c slave driver.

	  This driver is used for reporting thermal data via I2C
	  SMBUS to remote host.
	  Enable this option if you want to have support for thermal
	  management controller
	  Say Y if using a processor that includes the Intel VPU such as
	  Keem Bay.  If unsure, say N.

config KEEMBAY_THERMAL
	tristate "Temperature sensor driver for intel Keem Bay"
	depends on INTEL_TSENS_LOCAL_HOST && ARCH_KEEMBAY
	help
	  Enable this option if you want to have support for Keem Bay
	  thermal management sensors.

	  This driver is used for reading onchip temperature sensor
	  values from Keem Bay SoC.
	  Say Y if using a processor that includes the Intel VPU such as
	  Keem Bay.  If unsure, say N.
config INTEL_TSENS_IA_HOST
	tristate "Temperature sensor driver for intel tsens remote host"
	depends on I2C && THERMAL
	depends on I2C_SMBUS
	help
	  This option enables tsens i2c and thermal local Host driver.

	  This driver is used for reading thermal data via I2C SMBUS
	  and registers itself to thermal framework, which can be
	  used by thermal daemon in remote IA host
	  Say Y if using a processor that includes the Intel VPU such as
	  Keem Bay.  If unsure, say N.

config MOVIDIUS_VPU_COOLING
	tristate "Movidius VPU Cooling Driver"
	depends on KEEMBAY_THERMAL
	help
	  Enable this option if you want to have support for vpu cooling
	  driver for Movidius VPU

	  Movidius VPU coooling driver is registered as one of the
	  cooling agent to thermal framework. This driver communicates
	  with vpu to get/set power modes based on the thermal driver
	  requested states.
	  Say Y if using a processor that includes the Intel VPU such as
	  Keem Bay.  If unsure, say N.
```

## drivers/misc/mei/dal/Kconfig
```kconfig
# SPDX-License-Identifier: GPL-2.0
# Copyright (c) 2016-2019, Intel Corporation.
config INTEL_MEI_DAL
	tristate "Dynamic Application Loader for ME"
	depends on INTEL_MEI
	help
	  Dynamic Application Loader enables downloading java applets
	  to DAL FW and run it in a secure environment.
	  The DAL module exposes both user space api and kernel space api.
```

## drivers/misc/mei/iaf/Kconfig
```kconfig
# SPDX-License-Identifier: GPL-2.0
# Copyright (c) 2020-2021, Intel Corporation. All rights reserved.
#
config INTEL_MEI_IAF
	tristate "Intel Accelerator Fabric services of ME Interface"
	select INTEL_MEI_ME
	depends on DRM_I915
	help
	  MEI Support for IAF Services on Intel graphics card.

	  Enables the ME FW services required for IAF support through
	  I915 display driver of Intel.
```

## drivers/misc/noc/Kconfig
```kconfig
# Copyright (C) 2019 Intel Corporation
# SPDX-License-Identifier: GPL-2.0-only


config NOC_DSS
	tristate "Enable DSS NOC probing"
	depends on ARCH_KEEMBAY
	default y
	help
	  Enable this option for DSS bandwidth measurements using noc

	  Add support for Network on chip (NOC) counters. Enable features
	  to configure nd capture NOC probe counters, needed for DSS
	  bandwidth measurement.
	  Say Y if using a processor that includes the Intel VPU such as
	  Keem Bay.  If unsure, say N.
```

## drivers/misc/slave_kmb_tj/Kconfig
```kconfig
config SLAVE_KMB_TJ
	tristate "KMB Tj in slave mode"
	default y
	help
	  Enable this option if you want to have support for thermal management
	  controller present in Keembay
```

## drivers/misc/thermal/Kconfig
```kconfig
config KEEMBAY_THERMAL
	tristate "Temperature sensor driver for intel keembay"
	default y
	help
	  Enable this option if you want to have support for thermal management
	  controller present in Keembay

config KEEMBAY_COOLING
	tristate "dummy cooling driver for intel keembay"
	default y
	help
	  Enable this option if you want to have support for thermal management
	  controller present in Keembay
```

## drivers/misc/virtio-coreu/Kconfig
```kconfig
config INTEL_COREU_VIRTIO
        tristate "Intel CoreU virtio front end driver"
        depends on X86 && PCI && VIRTIO_PCI
        help
          CoreU virtio front end driver for virtualized system
```

## drivers/misc/virtio-hdcp/Kconfig
```kconfig
config INTEL_HDCP_VIRTIO
        tristate "Intel HDCP Virtio Front-end Driver"
        depends on X86 && PCI && VIRTIO_PCI
        help
          HDCP Virtio Front-end driver for virtualized system
```

## drivers/misc/vpumgr/Kconfig
```kconfig
config VPUMGR
	tristate "VPU Manager"
	depends on ARM64 && XLINK_CORE
	help
	  VPUMGR manages life-cycle of VPU related resources which were
	  dynamically allocated on demands of user-space application

	  Select y or m if you have a processor including the Intel
	  Vision Processor (VPU) on it.
```

## drivers/misc/vpusmm/Kconfig
```kconfig
# Copyright (C) 2019 Intel Corporation
# SPDX-License-Identifier: GPL-2.0-only

config VPUSMM
	tristate "Support for VPU Shared memory management"
	help
	  VPUSMM exposes following capabilities to user space application
	  through ioctl syscall:
	    1. allocate DMABuf qualified to be accessed by KeemBay VPU Sub-System.
	    2. import/unimport qualified DMABuf for VPU to access.
	    3. translate user-space virtual address within a mem-mapped
	       region of an imported DMABuf into VPU side DMA address,
	       which allows application to pass buffer pointer with
	       offsets to VPU sub-system.
```

## drivers/misc/xlink-core/Kconfig
```kconfig
config XLINK_CORE
	tristate "Support for XLINK CORE"
	depends on ((XLINK_PCIE_RH_DRIVER || XBAY_XLINK_PCIE_RH_DRIVER) || \
                    (XLINK_LOCAL_HOST && \
                    (XLINK_PCIE_LH_DRIVER || XBAY_XLINK_PCIE_RH_DRIVER)))
	help
	  XLINK CORE enables the communication/control subsystem.

	  If unsure, say N.

	  To compile this driver as a module, choose M here: the
	  module will be called xlink.ko.

config XLINK_LOCAL_HOST
	tristate "Support for XLINK LOCAL HOST"
	depends on XLINK_IPC
	help
	  XLINK LOCAL HOST enables local host functionality for
	  the communication/control Sub-System.

	  Enable this config when building the kernel for the Intel Vision
	  Processing Unit (VPU) Local Host core.

	  If building for a Remote Host kernel, say N.

config XLINK_PSS
	tristate "Support for XLINK PSS (Pre-Silicon Solution)"
	depends on XLINK_LOCAL_HOST
	help
	  XLINK PSS enables the communication/control subsystem on a PSS platform.

	  Enable this config when building the kernel for the Intel Vision
	  Processing Unit (VPU) in a simulated environment.

	  If building for a VPU silicon, say N.
```

## drivers/misc/xlink-ipc/Kconfig
```kconfig
config XLINK_IPC
	tristate "Support for XLINK IPC"
	depends on KEEMBAY_VPU_IPC
	help
	  XLINK IPC enables the communication/control IPC Sub-System.

	  Select M if you have an Intel SoC with a Vision Processing Unit (VPU).
```

## drivers/misc/xlink-pcie/Kconfig
```kconfig
config XLINK_PCIE_LH_DRIVER
	tristate "XLink PCIe Local Host driver"
	depends on PCI_ENDPOINT && ARCH_KEEMBAY
	help
	  This option enables XLink PCIe Local Host driver.

	  Choose M here to compile this driver as a module, name is mxlk_ep.
	  This driver is used for XLink communication over PCIe and is to be
	  loaded on the Intel Keem Bay platform.
```

## drivers/misc/xlink-smbus/Kconfig
```kconfig
# Copyright (C) 2020 Intel Corporation
# SPDX-License-Identifier: GPL-2.0-only

config XLINK_SMBUS
	tristate "Enable smbus interface over Xlink PCIe"
	depends on XLINK_CORE
	depends on HDDL_DEVICE_CLIENT || HDDL_DEVICE_SERVER
	help
	 Enable xlink-pcie as i2c adapter both slave and master. The server
	 (Remote Host) will use this interface to get sensor data from the soc
	 (vision accelerator - Local Host) which is connected over PCIe.
	 This driver is loaded on both Remote Host and Local Host.
	 Select M to compile the driver as a module, name is xlink-smbus.
	 If unsure, select N.


config XLINK_SMBUS_PROXY
	tristate "Enable SMBUS adapter as proxy for I2C controller"
	depends on XLINK_CORE
	depends on XLINK_SMBUS
	help
	 Enable this config when SMBUS adapter is acting as proxy for
	 another I2C controller.
	 Select M or Y if building for Intel Vision Processing Unit (VPU)
	 Local Host core.
	 Select N, if building for a Remote Host kernel.
```

## drivers/misc/xlink-usb/Kconfig
```kconfig
config XLINK_USB_LH_DRIVER
	tristate "XLink USB Local Host driver"
	depends on TTY
	select USB_LIBCOMPOSITE
	select USB_U_XLINK
	select USB_F_VPUUSB
	select USB_GADGET
	help
	  This option enables XLink USB Local Host driver.

          This driver exposes a char device for use.

          Choose M here to compile this driver as a module.

config USB_U_XLINK
	tristate

config USB_F_VPUUSB
	tristate

config XLINK_USB_RH_DRIVER
	tristate "XLink USB Remote Host driver"
	depends on TTY
	depends on !XLINK_USB_LH_DRIVER
	help
	  This driver supports USB modems and ISDN adapters which support the
	  Communication Device Class Abstract Control Model interface.

	  To compile this driver as a module, choose M here: the
	  module will be called cdc-acm.
```

## drivers/net/ethernet/intel/Kconfig.debug
```kconfig
# SPDX-License-Identifier: GPL-2.0-only
config IGC_TSN_TRACE
	bool "Enable TSN trace printk events"
	depends on IGC
	select TRACING
	default n
	help
	  Choose this option to turn on low level request tracing events.
	  This provides the ability to precisely monitor TSN scheduling
	  mechanism and also analyze the L2-packet timeline.

	  Recommended for driver developers only.

	  If in doubt, say "N".

config STMMAC_TSN_TRACE
	bool "Enable TSN trace printk events"
	depends on STMMAC_PCI
	select TRACING
	default n
	help
	  Choose this option to turn on low level request tracing events.
	  This provides the ability to precisely monitor TSN scheduling
	  mechanism and also analyze the L2-packet timeline.

	  Recommended for driver developers only.

	  If in doubt, say "N".
```

## drivers/net/networkproxy/Kconfig
```kconfig
config NETWORK_PROXY
	tristate "Network Proxy"
	depends on CONFIGFS_FS && INTEL_ISH_HID
	select NETWORK_PROXY_ISHTP
	help
	  Network proxy maintains network presence while Host is in
	  low-power mode. Host is woke-up when there is print job or
	  other packet of interest not handled by Network Proxy agent.
	  This technology is described in ECMA-393 proxZzzy.
	  It requires 2 devices to be registered to the Network Proxy
	  framework: IPC Device and Network Device.

config NETWORK_PROXY_ISHTP
	tristate "Network Proxy ISHTP"
	depends on NETWORK_PROXY
	help
	  Network Proxy framework communicates with the firmware of
	  Network Proxy agent using HECI interface. Therefore, selecting
	  this will also turn on INTEL_ISH_HID option.
```

## drivers/net/vnic/Kconfig
```kconfig
# SPDX-License-Identifier: GPL-2.0-only

config INTEL_ISHTP_VNIC
	tristate "Intel ISHTP VNIC controller"
	depends on INTEL_ISH_HID
	depends on NET
	help
	  If you say Y here, you get support for communicating with
	  Intel Programmable Services Engine (PSE) using a virtual newtwork
	  interface over ISH Transport Protocol (ISHTP) on Intel Elkhart Lake
	  platforms.
```
