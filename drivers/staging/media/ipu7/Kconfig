## drivers/staging/media/ipu7/Kconfig
```kconfig
config VIDEO_INTEL_IPU7
	tristate "Intel IPU7 driver"
	depends on ACPI || COMPILE_TEST
	depends on VIDEO_DEV
	depends on X86 && HAS_DMA
	depends on IPU_BRIDGE || !IPU_BRIDGE
        #
        # This driver incorrectly tries to override the dma_ops.  It should
        # never have done that, but for now keep it working on architectures
        # that use dma ops
        #
        depends on ARCH_HAS_DMA_OPS
	select AUXILIARY_BUS
	select IOMMU_IOVA
	select VIDEO_V4L2_SUBDEV_API
	select MEDIA_CONTROLLER
	select VIDEOBUF2_DMA_SG
	select V4L2_FWNODE
	help
	  This is the 7th Gen Intel Image Processing Unit, found in Intel SoCs
	  and used for capturing images and video from camera sensors.

	  To compile this driver, say Y here! It contains 3 modules -
	  intel_ipu7, intel_ipu7_isys and intel_ipu7_psys.

config VIDEO_INTEL_IPU7_MGC
	bool "Compile for IPU7 MGC driver"
	depends on VIDEO_INTEL_IPU7
	help
	  If selected, MGC device nodes would be created.

	  Recommended for driver developers only.

	  If you want to the MGC devices exposed to user as media entity,
	  you must select this option, otherwise no.

config VIDEO_INTEL_IPU7_ISYS_RESET
	bool "IPU7 ISYS RESET"
	depends on VIDEO_INTEL_IPU7
	default n
	help
		This option enables IPU7 ISYS reset feature to support
		HDMI-MIPI converter hot-plugging.

	  	If doubt, say N here.
```

## sound/usb/btusb/Kconfig
```kconfig
config BT_SCOHCI
	tristate "BT HCI USB driver"
	depends on BT
	help
	  Bluetooth SCO USB driver.
	  This driver is required if you want to use Bluetooth devices with
	  USB interface to support SCO.

	  Say Y here to compile support for Bluetooth USB devices into the
	  kernel or say M to compile it as module (btusb)
```
