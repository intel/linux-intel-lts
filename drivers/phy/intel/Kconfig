## drivers/phy/intel/Kconfig
```kconfig
config PHY_KEEMBAY_EMMC
	tristate "Intel Keem Bay EMMC PHY driver"
	depends on ARM64 || COMPILE_TEST
	depends on OF && HAS_IOMEM
	select GENERIC_PHY
	select REGMAP_MMIO
	help
	  Choose this option if you have an Intel Keem Bay SoC.

	  To compile this driver as a module, choose M here: the module
	  will be called phy-keembay-emmc.

config PHY_KEEMBAY_USB
	tristate "Intel Keem Bay USB PHY driver"
	depends on ARM64 || COMPILE_TEST
	depends on OF && HAS_IOMEM
	select GENERIC_PHY
	select REGMAP_MMIO
	help
	  Choose this option if you have an Intel Keem Bay SoC.

	  To compile this driver as a module, choose M here: the module
	  will be called phy-keembay-usb.
```

## drivers/platform/x86/intel/Kconfig
```kconfig
# SPDX-License-Identifier: GPL-2.0-only
#
# Intel x86 Platform Specific Drivers
#

source "drivers/platform/x86/intel/pmc/Kconfig"

config INTEL_VSEC
	tristate "Intel Vendor Specific Extended Capabilities Driver"
	depends on PCI
	select AUXILIARY_BUS
	help
	  Adds support for feature drivers exposed using Intel PCIe VSEC and
	  DVSEC.

	  To compile this driver as a module, choose M here: the module will
	  be called intel_vsec.
```

## drivers/platform/x86/sepdk/Kconfig
```kconfig
#
# THE SEP KERNEL DRIVER UNDER LINUX*
#
config INTEL_SEP
	bool "Sampling Enabling Product (SEP)"
	help
	  SEP is a command line tool for doing hardware-based sampling using
	  event-based sampling (EBS).
	depends on X86 || X86_64
	default y

config SEP
	tristate "SEP kernel driver"
	depends on INTEL_SEP
	default m

config SEP_ACRN
	tristate "SEP kernel driver"
	depends on INTEL_SEP && ACRN_VHM
	default m

config SEP_PAX
	tristate "PAX kernel driver from SEP"
	depends on INTEL_SEP
	depends on SEP
	default m

config SEP_PER_USER_MODE
	bool "Use Per User Mode on SEP"
	depends on INTEL_SEP
	default n

choice
	prompt "Choose log mode"
	default SEP_STANDARD_MODE
	depends on INTEL_SEP
	help
	  This option allows to select logging mode.

config SEP_STANDARD_MODE
	bool "Use standard logging mode"

config SEP_MINLOG_MODE
	bool "Use min logging mode"
	help
	  WARNING: Using minimal logging mode.
	  This may make troubleshooting more difficult.

config SEP_MAXLOG_MODE
	bool "Use max logging mode"
	help
	  WARNING: Using maximal logging mode.
	  This may increase overhead

endchoice
```

## drivers/platform/x86/socperf/Kconfig
```kconfig
config INTEL_SOCPERF
	bool "Socperf kernel driver"
	depends on X86 || X86_64
	default y

config SOCPERF
	tristate "Socperf kernel driver"
	depends on INTEL_SOCPERF
	depends on ACPI && PCI
	default m
```

## drivers/platform/x86/socwatch/Kconfig
```kconfig
menuconfig INTEL_SOCWATCH
	depends on X86 || X86_64
	tristate "SocWatch Driver Support"
	default m
	help
	  Say Y here to enable SocWatch driver
```

## drivers/platform/x86/socwatchhv/Kconfig
```kconfig
menuconfig INTEL_SOCWATCH_HV
	depends on (X86 || X86_64) && ACRN_VHM && ACRN_SHARED_BUFFER
	tristate "SocWatch Hypervisor Driver Support"
	default m
	help
	  Say Y here to enable SocWatch hypervisor driver
```

## drivers/sdw/Kconfig
```kconfig
menuconfig SDW
	tristate "SoundWire bus support"
	help
	  SoundWire interface is typically used for transporting data
	  related to audio functions.
menuconfig SDW_CNL
	tristate "Intel SoundWire master controller support"
	depends on SDW
	help
	  Intel SoundWire master controller driver
```

## drivers/soc/intel/Kconfig
```kconfig
# SPDX-License-Identifier: GPL-2.0-only
#
# Intel SoC drivers
#

menu "Intel SoC drivers"

config KEEMBAY_IPC
	tristate "Support for Intel Keem Bay IPC"
	depends on ARM64 && OF || COMPILE_TEST
	help
	  Keem Bay IPC enables communication between the Keem Bay CPU
	  Sub-System (CSS) and the Keem Bay Media Sub-System (MSS).

	  Select this if you are compiling the Kernel for the Intel Movidius
	  SoC code named Keem Bay.

endmenu
```

## drivers/staging/android/Kconfig
```kconfig
# SPDX-License-Identifier: GPL-2.0
menu "Android"

if ANDROID

config ASHMEM
	bool "Enable the Anonymous Shared Memory Subsystem"
	depends on SHMEM
	help
	  The ashmem subsystem is a new shared memory allocator, similar to
	  POSIX SHM but with different behavior and sporting a simpler
	  file-based API.

	  It is, in theory, a good memory allocator for low-memory devices,
	  because it can discard shared memory units when under memory pressure.

config DEBUG_KINFO
	bool "Debug Kernel Information Support"
	depends on KALLSYMS
	help
	  This supports kernel information backup for bootloader usage.
	  Specifics:
	   - The kallsyms symbols for unwind_backtrace
	   - Page directory pointer
	   - UTS_RELEASE
	   - BUILD_INFO(ro.build.fingerprint)

config ANDROID_FWDATA
	tristate "Parser for Android-specific firmware data"
	depends on ACPI
	default n
	help
	  This driver parses Android-specific data (e.g. fstab configuration)
	  stored in firmware (e.g. ACPI tables), and present it to user space
	  via sysfs. Android Oreo (8.0) and later requires some essential boot-
	  time configuration to be available in a directory structure organized
	  in Device Tree style, e.g. /proc/device-tree/firmware/android/ on
	  platforms that enable DT. Platforms that use ACPI instead of DT, such
	  as Goldfish (Ranchu) x86/x86_64, should enable this driver to ensure
	  the required information can be found in sysfs with the expected
	  layout.

source "drivers/staging/android/abl/Kconfig"
source "drivers/staging/android/sbl/Kconfig"
source "drivers/staging/android/vsbl/Kconfig"

endif # if ANDROID

endmenu
```

## drivers/staging/android/abl/Kconfig
```kconfig
config ABL_BOOTLOADER_CONTROL
        tristate "ABL Bootloader Control module"
        default n
        help
          This driver installs a reboot hook, such that if reboot() is
          invoked with a string argument, the corresponding ABL Action
          is written in CMOS data, in order to be processed by ABL on
          reboot.

config SEND_SLCAN_ENABLE
        bool "control slcan protocol"
        default n
        help
          This option control slcan protocol enable/disable in ablbc driver
          The IOC compononent on broxton IVI platform use slcan protocol to
          communicate befor calling powerctl program.
          If no use IOC, this option can be disabed.
```

## drivers/staging/android/vsbl/Kconfig
```kconfig
config VSBL_BOOTLOADER_CONTROL
        tristate "vSBL Bootloader Control module"
        depends on X86
        default n
        help
          This driver installs a reboot hook, such that if reboot() is
          invoked with a string argument, the corresponding ABL Action
          is written in CMOS data, in order to be processed by ABL on
          reboot.
```

## drivers/tcc/Kconfig
```kconfig
# SPDX-License-Identifier: GPL-2.0

menuconfig X86_TCC_PTCM
    tristate "TCC_PTCM interface driver"
    depends on X86 && ACPI
    help
      Select this option to access PTCM feature.

      If unsure, say N.
```

## drivers/usb/typec/Kconfig
```kconfig
menu "USB PD and Type-C drivers"

config TYPEC
	tristate

config USB_PD_SINK
	bool "USB Power Delivery Sink Port State Machine Driver"
	select TYPEC
	help
	  Enable this to support USB PD(Power Delivery) Sink port.
	  This driver implements a simple USB PD sink state machine.
	  The underlying TypeC phy driver is responsible for cable
	  plug/unplug event, port orientation detection, transmitting
	  and receiving PD messages. This driver only process messages
	  received by the TypeC phy driver and maintain the sink port's
	  state machine.

config TYPEC_WCOVE
	tristate "Intel WhiskeyCove PMIC USB Type-C PHY driver"
	depends on ACPI
	depends on INTEL_SOC_PMIC
	depends on INTEL_PMC_IPC
	select TYPEC
	select USB_PD_SINK
	help
	  This driver adds support for USB Type-C detection on Intel Broxton
	  platforms that have Intel Whiskey Cove PMIC. The driver can detect the
	  role and cable orientation.

	  To compile this driver as module, choose M here: the module will be
	  called typec_wcove

endmenu
```

## drivers/usb/typec/ccg/Kconfig
```kconfig
# SPDX-License-Identifier: GPL-2.0

config TYPEC_CCG_HPI
	tristate "Cypress CCG Host Processor Interface"
	depends on I2C
	select REGMAP_I2C
	help
	  This driver adds support for Cypress CCG1, CCG2, CCG3, CCG4, CCG5 and
	  CCG6 USB Power Delivery controllers. The primary interface with
	  Cypress CCGx USB PD controllers is called HPI (Host Processor
	  Interface). Later generations (CCG4, CCG5 and CCG6) also support UCSI,
	  but Cypress CCGx UCSI support is handled in its own driver ucsi_ccg.c.
```

## drivers/vbs/Kconfig
```kconfig
#
# This Kconfig describes VBS for ACRN hypervisor
#
config VBS
	tristate "Enable VBS framework for ACRN hypervisor"
	depends on ACRN_GUEST
	depends on ACRN_VHM
	default n
	---help---
	  This option is selected by any driver which needs to use
	  the Virtio Backend Service (VBS) framework on ACRN
	  hypervisor.

config VBS_DEBUG
	bool "ACRN VBS debugging"
	depends on VBS != n
	default n
	---help---
	  This is an option for use by developers; most people should
	  say N here.  This enables ACRN VBS debugging.
```

## drivers/vfio/pci/i915/Kconfig
```kconfig
# SPDX-License-Identifier: GPL-2.0-only

config I915_VFIO_PCI
	tristate "VFIO vendor-specific PCI driver for Intel Graphics"
	depends on DRM_I915
	help
	  This option enables vendor-specific VFIO driver for Intel Graphics.
	  In addition to generic VFIO PCI functionality, it implements VFIO
	  migration uAPI (v1) allowing userspace to enable migration for
	  Intel Graphics SR-IOV Virtual Functions.

config I915_VFIO_PCI_TEST
	tristate "KUnit tests for Intel Graphics VFIO" if !KUNIT_ALL_TESTS
	depends on I915_VFIO_PCI && KUNIT
	default KUNIT_ALL_TESTS
	help
	  This option enables unit tests for i915-vfio-pci.
	  It is not useful for distributions or general kernels,
	  but only for kernel developers working on the driver.

	  For more information on KUnit and unit tests in general,
	  please refer to the KUnit documentation in
	  Documentation/dev-tools/kunit/.

	  If in doubt, say "N".
```

## kernel/Kconfig.dovetail
```kconfig
# DOVETAIL dual-kernel interface
config HAVE_DOVETAIL
	bool

# Selecting ARCH_WANT_IRQS_OFF_ACTIVATE_MM in this generic Kconfig
# portion is ugly, but the whole ARCH_WANT_IRQS_OFF_ACTIVATE_MM logic
# is a temporary kludge which is meant to disappear anyway. See
# the related comments in exec_mmap() for details.
config DOVETAIL
	bool "Dovetail interface"
	depends on HAVE_DOVETAIL
	select IRQ_PIPELINE
	select ARCH_WANT_IRQS_OFF_ACTIVATE_MM
	default n
	help
	  Activate this option if you want to enable the interface for
	  running a high-priority software core on the out-of-band
	  pipeline stage (aka "dual kernel" configuration).

config DOVETAIL_LEGACY_SYSCALL_RANGE
       depends on DOVETAIL
       def_bool y

# The nickname of the guest companion core using Dovetail to attach to
# the main kernel. Advertise mere dovetailing only if none.
config DOVETAIL_GUEST
       string
       depends on DOVETAIL
       default "$(shell,$(srctree)/scripts/dovetail-guest.sh 2>/dev/null || echo DOVETAIL)"
```

## security/keystore/Kconfig
```kconfig
config KEYSTORE
	tristate "Keystore"
        depends on INTEL_MEI_DAL
	default n
	help
		An system deals with various keys that need to be stored
		securely on the platform. Some of the keys are stored in
		specific embedded hardware but others are required by
		algorithms running on Linux. The keystore is designed to
		provide a secure storage solution for such keys. Applications
		interface is through the char device ioctls on /dev/keystore.

		If in doubt, say "N".

config KEYSTORE_DEBUG
	bool "Keystore enable additional debug messages"
	depends on KEYSTORE
        default n
	help
		Provides additional debug prints, hexdumps during keystore
		operation. Includes hexdump of cryptographic data structures
		such as public keys.

		Should not be enabled in production as it will expose
		sensitive information!

		If unsure, select "N".

config DAL_KEYSTORE_APPLET_PATH
	string "DAL Keystore Applet path"
	depends on KEYSTORE
	default "/var/lib/intel/dal/applets/Keystore.pack"
	help
		The path for DAL Keystore applet file.

config DAL_KEYSTORE_APPLET_ID
	string "DAL Keystore Applet UUID"
	depends on KEYSTORE
	default "c12452f0adc640a78623708f0f4f0e52"
	help
		DAL Keystore applet UUID.
```

## security/keystore/oemkey/Kconfig
```kconfig
config MANIFEST
	tristate "Manifest Provisioning and Verification"
	default n
	select KEYS
	select ASYMMETRIC_KEY_TYPE
	select ASYMMETRIC_PUBLIC_KEY_SUBTYPE
	select PUBLIC_KEY_ALGO_RSA
	select CRYPTO_RSA
	select MPILIB
	select X509_CERTIFICATE_PARSER
	select ABL_PARAMMETERS
	select ABL_CMDLINE
	help
		A module which reads the manifest passed to the kernel
		by the bootloader. Allows applications to verify digest
		signatures against the key digest signatures provided
		by the manifest.

                If in doubt, select "N".

config MANIFEST_HARDCODE
	bool "Hardcode the manifest"
        default n
	depends on MANIFEST
	help
                Sets the manifest to fixed values instead
                of using values passed via the kernel command line.

                WARNING: This is only for testing purposes and should not be used
                for production as any data encrypted with keystore will be vulnerable
                to attack.

                If in doubt, select "N".

config ABL_PARAMETERS
	bool "Retrieve OEM Keys From ABL Parameters"
        default n
	help
		A module which locates the oem keys from abl command line parameters.
		Manifest module will retrieve the manifest key to verify the public key
		in manifest file.

		If in double, select "N".

config ABL_CMDLINE
	bool "Secure command line copy functions"
        default n
	help
		A module which provides secure command line copy functions
		needed by manifest module.

		If in double, select "N".
```

## sound/soc/intel/skylake/virtio/Kconfig
```kconfig
config SND_SOC_INTEL_SKYLAKE_VIRTIO_FE
	tristate "SKL/BXT/KBL/GLK/CNL... Platforms Virtio FrontEnd"
	depends on ACRN_VIRTIO_DEVICES && SND_SOC_INTEL_SKYLAKE && SND_SOC_INTEL_SKYLAKE_VIRTIO_BE=n
	help
	  Enables virtio frontend for Intel Skylake audio driver.
	  This option should be enabled only on Guest OS.
	  Say Y or m if you have such a device.
	  If unsure select "N".

config SND_SOC_INTEL_SKYLAKE_VIRTIO_BE
	tristate "SKL/BXT/KBL/GLK/CNL... Platforms Virtio BackEnd"
	depends on VBS && SND_SOC_INTEL_SKYLAKE
	help
	  Enables virtio backend for Intel Skylake audio driver.
	  This option should be enabled only on Service OS.
	  Say Y or m if you have such a device.
	  If unsure select "N".
```
