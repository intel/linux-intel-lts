## Documentation/devicetree/bindings/spi/snps,dw-apb-ssi.txt
```
Synopsys DesignWare AMBA 2.0 Synchronous Serial Interface.

Required properties:
- compatible : "snps,dw-apb-ssi" or "mscc,<soc>-spi", where soc is "ocelot" or
  "jaguar2", or "amazon,alpine-dw-apb-ssi", or "snps,dwc-ssi-1.01a" or
  "intel,keembay-ssi"
- reg : The register base for the controller. For "mscc,<soc>-spi", a second
  register set is required (named ICPU_CFG:SPI_MST)
- interrupts : One interrupt, used by the controller.
- #address-cells : <1>, as required by generic SPI binding.
- #size-cells : <0>, also as required by generic SPI binding.
- clocks : phandles for the clocks, see the description of clock-names below.
   The phandle for the "ssi_clk" is required. The phandle for the "pclk" clock
   is optional. If a single clock is specified but no clock-name, it is the
   "ssi_clk" clock. If both clocks are listed, the "ssi_clk" must be first.

Optional properties:
- clock-names : Contains the names of the clocks:
    "ssi_clk", for the core clock used to generate the external SPI clock.
    "pclk", the interface clock, required for register access.
- cs-gpios : Specifies the gpio pins to be used for chipselects.
- num-cs : The number of chipselects. If omitted, this will default to 4.
- reg-io-width : The I/O register width (in bytes) implemented by this
  device.  Supported values are 2 or 4 (the default).

Child nodes as per the generic SPI binding.

Example:

	spi@fff00000 {
		compatible = "snps,dw-apb-ssi";
		reg = <0xfff00000 0x1000>;
		interrupts = <0 154 4>;
		#address-cells = <1>;
		#size-cells = <0>;
		clocks = <&spi_m_clk>;
		num-cs = <2>;
		cs-gpios = <&gpio0 13 0>,
			   <&gpio0 14 0>;
	};

Optional properties for Microwire Intel Keembay SOC:

- dw,ssi-type : Frame format Selection for serial protocol transfers
  <0>: Motorola
  <1>: Texas Instrument
  <2>: Microwire

- dw,ssi-mdd : Microwire Control. Defines the direction of the data word when the Microwire
  serial protocol is used. When this bit is set to 0, the data word is received by Keembay Master
  from the external slave device. When this bit is set to 1, the data word is received by
  Slave device from Keembay Master.

- dw,ssi-cfs : Control frame size to select the length of the control word
  for Microwire. Control words length can be set between (1 -16) bits.
  Define <16> to set 16-bit control word.

- dw,ssi-mwmod : Defines whether transfer is sequential or non-sequential
  for Microwire.
  <0>: Non-Sequential Microwire Transfer
  <1>: Sequential Microwire Transfer

- dw,ssi-cword : Specify the value of control words for Microwire.
  Values can be set between (0-65535) which is up to 16 bit of data.
  Used when dw-ssi-mdd equal to 0.

- cont-non-sequential : Variable to write more control words into tx fifo
  for Microwire. Define when to perform continuous non sequential operations.

SSI as transmit data example:

Non Sequential Microwire Transmit:

	spi@201c0000 {
			compatible = "snps,dw-ahb-ssi";
			reg = <0x00000000 0x201c0000 0x00000000 0x00000110>;
			interrupts = <0x00000000 0x0000004a 0x00000004>;
			#address-cells = <0x00000001>;
			#size-cells = <0x00000000>;
			status = "okay";
			clocks = <0x00000006 0x00000043>;
			spidev@0 {
			};
			n25q128a {
			};
			dw,ssi-mdd = <0x00000001>;
			dw,ssi-cfs = <0x00000007>;
			dw,ssi-type = <0x00000002>;
			dw,ssi-mwmod = <0x00000000>;
	};

Continuous Non Sequential Microwire Transmit:

	spi@201c0000 {
			compatible = "snps,dw-ahb-ssi";
			reg = <0x00000000 0x201c0000 0x00000000 0x00000110>;
			interrupts = <0x00000000 0x0000004a 0x00000004>;
			#address-cells = <0x00000001>;
			#size-cells = <0x00000000>;
			status = "okay";
			clocks = <0x00000006 0x00000043>;
			spidev@0 {
			};
			n25q128a {
			};
			dw,ssi-mdd = <0x00000001>;
			dw,ssi-cfs = <0x00000007>;
			dw,ssi-type = <0x00000002>;
			dw,ssi-mwmod = <0x00000000>;
			cont-non-sequential;
	};

SSI as receives data :

Non Sequential Microwire Receives example:

	spi@201c0000 {
			compatible = "snps,dw-ahb-ssi";
			reg = <0x00000000 0x201c0000 0x00000000 0x00000110>;
			interrupts = <0x00000000 0x0000004a 0x00000004>;
			#address-cells = <0x00000001>;
			#size-cells = <0x00000000>;
			status = "okay";
			clocks = <0x00000006 0x00000043>;
			spidev@0 {
			};
			n25q128a {
			};
			dw,ssi-mdd = <0x00000000>;
			dw,ssi-cfs = <0x00000007>;
			dw,ssi-type = <0x00000002>;
			dw,ssi-mwmod = <0x00000000>;
			dw,ssi-cword = <0x000000aa>;
	};

Continuous Non Sequential Microwire Receives example:

	spi@201c0000 {
			compatible = "snps,dw-ahb-ssi";
			reg = <0x00000000 0x201c0000 0x00000000 0x00000110>;
			interrupts = <0x00000000 0x0000004a 0x00000004>;
			#address-cells = <0x00000001>;
			#size-cells = <0x00000000>;
			status = "okay";
			clocks = <0x00000006 0x00000043>;
			spidev@0 {
			};
			n25q128a {
			};
			dw,ssi-mdd = <0x00000000>;
			dw,ssi-cfs = <0x00000007>;
			dw,ssi-type = <0x00000002>;
			dw,ssi-mwmod = <0x00000000>;
			dw,ssi-cword = <0x000000aa>;
			cont-non-sequential;
	};

Sequential Microwire Receive example:

	spi@201c0000 {
			compatible = "snps,dw-ahb-ssi";
			reg = <0x00000000 0x201c0000 0x00000000 0x00000110>;
			interrupts = <0x00000000 0x0000004a 0x00000004>;
			#address-cells = <0x00000001>;
			#size-cells = <0x00000000>;
			status = "okay";
			clocks = <0x00000006 0x00000043>;
			spidev@0 {
			};
			n25q128a {
			};
			dw,ssi-mdd = <0x00000000>;
			dw,ssi-cfs = <0x00000007>;
			dw,ssi-type = <0x00000002>;
			dw,ssi-mwmod = <0x00000001>;
			dw,ssi-cword = <0x000000aa>;
	};
```

## Documentation/devicetree/bindings/timer/intel,keembay-timer.yaml
```yaml
# SPDX-License-Identifier: (GPL-2.0-only OR BSD-2-Clause)
%YAML 1.2
---
$id: http://devicetree.org/schemas/timer/intel,keembay-timer.yaml#
$schema: http://devicetree.org/meta-schemas/core.yaml#

title: Intel Keem Bay SoC Timers

maintainers:
  - Wan Ahmad Zainie <wan.ahmad.zainie.wan.mohamad@intel.com>
  - Vijayakannan Ayyathurai <vijayakannan.ayyathurai@intel.com>

description:
  Intel Keem Bay SoC Timers block contains 8 32-bit general purpose timers,
  a free running 64-bit counter, a random number generator and a watchdog
  timer. Each gpt can generate an individual interrupt.

properties:
  compatible:
    enum:
      - intel,keembay-timer

  reg:
    maxItems: 3

  clocks:
    maxItems: 1

  interrupts:
    maxItems: 1

required:
  - compatible
  - reg
  - interrupts
  - clocks

additionalProperties: false

examples:
  - |
    #include <dt-bindings/interrupt-controller/arm-gic.h>
    #include <dt-bindings/interrupt-controller/irq.h>
    #define KEEM_BAY_A53_TIM

    timer@20330010 {
        compatible = "intel,keembay-timer";
        reg = <0x20330010 0xc>,
              <0x203300e8 0xc>,
              <0x20331000 0xc>;
        clocks = <&scmi_clk KEEM_BAY_A53_TIM>;
        interrupts = <GIC_SPI 3 IRQ_TYPE_LEVEL_HIGH>;
    };
```

## arch/x86/acrn/Kconfig
```kconfig
# SPDX-License-Identifier: GPL-2.0
#
# This Kconfig describes ACRN options
#

config ACRN
	bool "Enable services run on ACRN hypervisor"
	depends on X86_64
	depends on PARAVIRT
	help
	  This option is needed if were to run ACRN services linux on top of
	  ACRN hypervisor.
```

## drivers/acrn/Kconfig
```kconfig
config ACRN_SHARED_BUFFER
	bool "Intel ACRN SHARED BUFFER"
	---help---
	  Ring buffer shared between ACRN Hypervisor and its SOS.
	  Help ACRN performance profiling.
```

## drivers/char/rpmb/Kconfig
```kconfig
# SPDX-License-Identifier: GPL-2.0
# Copyright (c) 2015-2019, Intel Corporation.

config RPMB
	tristate "RPMB partition interface"
	help
	  Unified RPMB partition interface for eMMC and UFS.
	  Provides interface for in kernel security controllers to
	  access RPMB partition.

	  If unsure, select N.
```

## drivers/char/rpmb/mux/Kconfig
```kconfig
# SPDX-License-Identifier: GPL-2.0
# Copyright (c) 2018-2019, Intel Corporation.

config RPMB_MUX
	tristate "RPMB Mux kernel module interface /dev/rpmbmux"
	default n
	select RPMB
	select CRYPTO_SHA256
	select CRYPTO_HMAC
	help
	  Say yes here if you want to access RPMB from user space
	  via character device interface /dev/rpmbmux, which  acts
	  as a multiplexor above RPMB native driver.

	  RPMB MUX owns RPMB authentication key internally for RPMB
	  virtualization usage.
```

## drivers/crypto/keembay/Kconfig
```kconfig
config CRYPTO_DEV_KEEMBAY_OCS_SYM_CIPHER
	tristate "Support for Keem Bay OCS symmetric cipher HW acceleration"
	select CRYPTO_SKCIPHER
	select CRYPTO_AEAD
	select CRYPTO_ENGINE

	help
	  Support for Keem Bay Offload and Crypto Subsystem (OCS) AES and/or
	  SM4 cihper hardware acceleration for use with Crypto API.

	  CRYPTO_DEV_KEEMBAY_OCS_SYM_CIPHER_AES and/or
	  CRYPTO_DEV_KEEMBAY_OCS_SYM_CIPHER_SM4 also needs to be selected
	  to make the OCS symmetric cipher functionality available through
	  the Crypto API

if CRYPTO_DEV_KEEMBAY_OCS_SYM_CIPHER

config CRYPTO_DEV_KEEMBAY_OCS_SYM_CIPHER_AES
	bool "Support for Keem Bay OCS AES HW acceleration"
	default y
	depends on CRYPTO_DEV_KEEMBAY_OCS_SYM_CIPHER

	help
	  Support for Keem Bay Offload and Crypto Subsystem (OCS)
	  AES hardware acceleration for use with Crypto API.

	  Provides OCS versions of cbc(aes), ctr(aes), ccm(aes) and gcm(aes),
	  with additional optional support for ecb(aes) and cts(cbc(aes)).

if CRYPTO_DEV_KEEMBAY_OCS_SYM_CIPHER_AES

config CRYPTO_DEV_KEEMBAY_OCS_SYM_CIPHER_AES_ECB
	bool "Support for Keem Bay OCS ECB(AES) HW acceleration"
	default n
	depends on CRYPTO_DEV_KEEMBAY_OCS_SYM_CIPHER
	depends on CRYPTO_DEV_KEEMBAY_OCS_SYM_CIPHER_AES

	help
	  Support for Keem Bay Offload and Crypto Subsystem (OCS)
	  AES ECB mode hardware acceleration for use with Crypto API.

	  Provides OCS versions of ecb(aes).

	  Intel does not recommend use of ECB mode with AES.

config CRYPTO_DEV_KEEMBAY_OCS_SYM_CIPHER_AES_CTS
	bool "Support for Keem Bay OCS CTS(CBC(AES)) HW acceleration"
	default n
	depends on CRYPTO_DEV_KEEMBAY_OCS_SYM_CIPHER
	depends on CRYPTO_DEV_KEEMBAY_OCS_SYM_CIPHER_AES

	help
	  Support for Keem Bay Offload and Crypto Subsystem (OCS)
	  AES CBC with CTS mode hardware acceleration for use with
	  Crypto API.

	  Provides OCS versions of cts(cbc(aes)).

	  Intel does not recommend use of CTS mode with AES.

endif # CRYPTO_DEV_KEEMBAY_OCS_SYM_CIPHER_AES

config CRYPTO_DEV_KEEMBAY_OCS_SYM_CIPHER_SM4
	bool "Support for Keem Bay OCS SM4 HW acceleration"
	default y
	depends on CRYPTO_DEV_KEEMBAY_OCS_SYM_CIPHER

	help
	  Support for Keem Bay Offload and Crypto Subsystem (OCS)
	  SM4 hardware acceleration for use with Crypto API.

	  Provides OCS versions of cbc(sm4), ctr(sm4), ccm(sm4) and gcm(sm4),
	  with additional optional support for ecb(sm4) and cts(cbc(sm4)).

if CRYPTO_DEV_KEEMBAY_OCS_SYM_CIPHER_SM4

config CRYPTO_DEV_KEEMBAY_OCS_SYM_CIPHER_SM4_ECB
	bool "Support for Keem Bay OCS ECB(SM4) HW acceleration"
	default n
	depends on CRYPTO_DEV_KEEMBAY_OCS_SYM_CIPHER
	depends on CRYPTO_DEV_KEEMBAY_OCS_SYM_CIPHER_SM4

	help
	  Support for Keem Bay Offload and Crypto Subsystem (OCS)
	  SM4 ECB mode hardware acceleration for use with Crypto API.

	  Provides OCS versions of ecb(sm4).

	  Intel does not recommend use of ECB mode with SM4.

config CRYPTO_DEV_KEEMBAY_OCS_SYM_CIPHER_SM4_CTS
	bool "Support for Keem Bay OCS CTS(CBC(SM4)) HW acceleration"
	default n
	depends on CRYPTO_DEV_KEEMBAY_OCS_SYM_CIPHER
	depends on CRYPTO_DEV_KEEMBAY_OCS_SYM_CIPHER_SM4

	help
	  Support for Keem Bay Offload and Crypto Subsystem (OCS)
	  SM4 CBC with CTS mode hardware acceleration for use with
	  Crypto API.

	  Provides OCS versions of cts(cbc(sm4)).

	  Intel does not recommend use of CTS mode with SM4.

endif # CRYPTO_DEV_KEEMBAY_OCS_SYM_CIPHER_SM4

endif # CRYPTO_DEV_KEEMBAY_OCS_SYM_CIPHER

config CRYPTO_DEV_KEEMBAY_OCS_HCU
	tristate "Support for Keem Bay OCS HCU HW acceleration"
	select CRYPTO_ENGINE

	help
	  Support for Keem Bay Offload and Crypto Subsystem (OCS)
	  HCU (Hash Control Unit) hardware acceleration for use
	  with Crypto API.

	  Provides OCS implementation of sha256, sha384, sha512 as well
	  as the HMAC variant of these algorithms.

config CRYPTO_DEV_KEEMBAY_OCS_HCU_HMAC_SHA224
	bool "Support for Keem Bay SHA224 and HMAC(SHA224) HW acceleration"
	default n
	depends on CRYPTO_DEV_KEEMBAY_OCS_HCU

	help
	  Enables support for the Keem Bay OCS HCU SHA224 and HMAC(SHA224)
	  algorithms. These algorithms are not recommended for use.

	  Provides OCS implementation of sha224 as well as the HMAC variant of
	  this algorithm.

config CRYPTO_DEV_KEEMBAY_OCS_ECC
	tristate "Support for Keembay OCS ECC HW acceleration"
	select CRYPTO_ECDH
	select CRYPTO_ENGINE

	help
	  Support for Keembay Offload and Crypto Subsystem (OCS)
	  ECC (Elliptic Curve Cryptography) hardware acceleration for use
	  with Crypto API.

	  Provides OCS acceleration for ECDH-256, ECDH-384.
```

## drivers/dma-buf/hyper_dmabuf/Kconfig
```kconfig
menuconfig HYPER_DMABUF
	bool "configure HyperDMABUF driver"
	default y
	depends on X86_64

if HYPER_DMABUF

choice
	prompt "Hypervisor"
	depends on HYPER_DMABUF
	default HYPER_DMABUF_XEN

config HYPER_DMABUF_XEN
	bool "XEN"
	depends on XEN
	help
	  Configuring hyper_dmabuf driver for XEN hypervisor

config HYPER_DMABUF_ACRN
	bool "ACRN"
	depends on ACRN_VIRTIO_DEVICES
	select VIRTIO
	help
	  Configuring hyper_dmabuf driver for ACRN hypervisor
endchoice

choice
        prompt "Virtio driver type"
        depends on HYPER_DMABUF_ACRN
        default HYPER_DMABUF_VIRTIO_BE

config HYPER_DMABUF_VIRTIO_BE
	depends on VBS && DRM_I915_GVT
	bool "virtio backend (SOS)"
	help
	  Configuring hyper_dmabuf driver as virtio backend
	  running from service OS

config HYPER_DMABUF_VIRTIO_FE
	depends on ACRN_VIRTIO_DEVICES
	bool "virtio frontend (UOS)"
	help
	  Configuring hyper_dmabuf driver as virtio frontend
	  running from guest OS
endchoice

config HYPER_DMABUF_SYSFS
	bool "Enable sysfs information about hyper DMA buffers"
	default y
	depends on HYPER_DMABUF
	help
	  Expose information about imported and exported buffers using
	  hyper_dmabuf driver

config HYPER_DMABUF_EVENT_GEN
	bool "Enable event-generation and polling operation"
	default n
	depends on HYPER_DMABUF
	help
	  With this config enabled, hyper_dmabuf driver on the importer side
	  generates events and queue those up in the event list whenever a new
	  shared DMA-BUF is available. Events in the list can be retrieved by
	  read operation.

config HYPER_DMABUF_XEN_AUTO_RX_CH_ADD
	bool "Enable automatic rx-ch add with 10 secs interval"
	default y
	depends on HYPER_DMABUF && HYPER_DMABUF_XEN
	help
	  If enabled, driver reads a node in xenstore every 10 seconds
	  to check whether there is any tx comm ch configured by another
	  domain then initialize matched rx comm ch automatically for any
	  existing tx comm chs.

endif
```

## drivers/gpu/drm/hantro/Kconfig
```kconfig
# SPDX-License-Identifier: GPL-2.0-only
config DRM_HANTRO_UNIFY
	tristate "Hantro DRM"
	depends on DRM
	depends on ARM64
	select DRM_PANEL
	select DRM_KMS_HELPER
	help
	  Choose this option if you have a system that has "Keem
	  Bay VPU" hardware which supports Verisilicon's Hantro
	  Video Processor Unit (VPU) IP, a series of video decoder
	  and encoder semiconductor IP cores which can be flexibly
	  configured for video surveillance, multimedia consumer
	  products, Internet of Things, cloud service products, data
	  centers, aerial photography and recorders, thereby providing
	  video transcoding and multi-channel HD video encoding and
	  decoding.

	  Hantro VC8000D allows 4K decoding that supports H264 and HEVC
	  video formats. Hantro VC8000E allows 4K encoding that supports
	  H264 and HEVC video formats.

config DRM_HANTRO_TRACEPOINTS
	bool "Hantro tracing"
	help
	  This option enables tracepoints for Keem Bay VPU DRM driver
```
