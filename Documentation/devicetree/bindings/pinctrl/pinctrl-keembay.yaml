## Documentation/devicetree/bindings/pinctrl/pinctrl-keembay.yaml
```yaml
# SPDX-License-Identifier: GPL-2.0
# Copyright (C) 2019, Intel Corporation
%YAML 1.2
---
$id: http://devicetree.org/schemas/pinctrl/pinctrl-keembay.yaml#
$schema: http://devicetree.org/meta-schemas/core.yaml#

title: Intel Keem Bay pin controller Device Tree Bindings

maintainers:
  - Vineetha G. Jaya Kumaran <vineetha.g.jaya.kumaran@intel.com>

description: |
  Intel Keem Bay SoC integrates a pin controller which enables control
  of pin directions, input/output values, configurations
  as well as multiplexing for a total of 80 pins.

properties:
  compatible:
    const: intel,keembay-pinctrl

  reg:
    minItems: 2
    maxItems: 2

  gpio-controller: true

  '#gpio-cells':
      const: 2

  interrupts:
    description:
      Specifies the interrupt lines to be used by the controller.
    maxItems: 8

  interrupt-controller: true

  '#interrupt-cells':
      const: 2

required:
  - compatible
  - reg
  - gpio-controller
  - '#gpio-cells'
  - interrupts
  - interrupt-controller
  - '#interrupt-cells'

patternProperties:
  '^.*$':

    type: object

    allOf:
      - $ref: pincfg-node.yaml#
      - $ref: pinmux-node.yaml#

    description:
      Child nodes can be specified to contain pin muxing or pin configuration information,
      which is then utilized by pinctrl client devices. The following properties are supported.

    function:
      description:
        The name of the function that a pin is to be muxed to.

    groups:
      description:
        The name(s) of the pin group to be enabled in a function.
        Each pin is classified as an individual group, hence supported group names are "GPIO0" to "GPIO79".

    pins:
      description:
        The name(s) of the pins to be configured in the child node.
        Supported pin names are "GPIO0" to "GPIO79".

    bias-disable:
      type: boolean

    bias-pull-down:
      type: boolean

    bias-pull-up:
      type: boolean

    bias-bus-hold:
      type: boolean

    input-schmitt-enable:
      type: boolean

    drive-strength:
      enum: [2, 4, 8, 12]

    slew-rate:
      enum: [0, 1]

examples:
  - |
    # Example 1
    pinctrl@600B0000 {
        compatible = "intel,keembay-pinctrl";
        reg = <0x0 0x600b0000 0x0 0x88>,
              <0x0 0x600b0190 0x0 0x1ac>;
        gpio-controller;
        #gpio-cells = <0x2>;
        interrupts = <GIC_SPI 94 IRQ_TYPE_LEVEL_HIGH>,
                     <GIC_SPI 95 IRQ_TYPE_LEVEL_HIGH>,
                     <GIC_SPI 96 IRQ_TYPE_LEVEL_HIGH>,
                     <GIC_SPI 97 IRQ_TYPE_LEVEL_HIGH>,
                     <GIC_SPI 98 IRQ_TYPE_LEVEL_HIGH>,
                     <GIC_SPI 99 IRQ_TYPE_LEVEL_HIGH>,
                     <GIC_SPI 100 IRQ_TYPE_LEVEL_HIGH>,
                     <GIC_SPI 101 IRQ_TYPE_LEVEL_HIGH>;
        interrupt-controller;
        #interrupt-cells = <2>;
    };

    # Example 2
    pinctrl@600B0000 {
        compatible = "intel,keembay-pinctrl";
        reg = <0x0 0x600b0000 0x0 0x88>,
              <0x0 0x600b0190 0x0 0x1ac>;
        gpio-controller;
        #gpio-cells = <0x2>;
        interrupts = <GIC_SPI 94 IRQ_TYPE_LEVEL_HIGH>,
                     <GIC_SPI 95 IRQ_TYPE_LEVEL_HIGH>,
                     <GIC_SPI 96 IRQ_TYPE_LEVEL_HIGH>,
                     <GIC_SPI 97 IRQ_TYPE_LEVEL_HIGH>,
                     <GIC_SPI 98 IRQ_TYPE_LEVEL_HIGH>,
                     <GIC_SPI 99 IRQ_TYPE_LEVEL_HIGH>,
                     <GIC_SPI 100 IRQ_TYPE_LEVEL_HIGH>,
                     <GIC_SPI 101 IRQ_TYPE_LEVEL_HIGH>;
        interrupt-controller;
        #interrupt-cells = <2>;

        i2s_pinmux {
            function = "I2S0_M0";
            groups = "GPIO0", "GPIO1";
        };

        spi_pinconf {
            pins = "GPIO10", "GPIO11";
            drive-strength = <4>;
            bias-pull-down;
        };
    };
```

## Documentation/devicetree/bindings/pwm/pwm-keembay.yaml
```yaml
# SPDX-License-Identifier: GPL-2.0
# Copyright (C) 2020 Intel Corporation
%YAML 1.2
---
$id: http://devicetree.org/schemas/pwm/pwm-keembay.yaml#
$schema: http://devicetree.org/meta-schemas/core.yaml#

title: Intel Keem Bay PWM Device Tree Bindings

maintainers:
  - Vineetha G. Jaya Kumaran <vineetha.g.jaya.kumaran@intel.com>

allOf:
  - $ref: pwm.yaml#

properties:
  compatible:
    enum:
      - intel,keembay-pwm

  reg:
    maxItems: 1

  clocks:
    description:
        phandle to the reference clock.

required:
 - compatible
 - reg
 - clocks

examples:
  - |
    pwm@203200a0 {
      compatible = "intel,keembay-pwm";
      reg = <0x0 0x203200a0 0x0 0xe8>;
      clocks = <&scmi_clk KEEM_BAY_A53_GPIO>;
    };
```

## Documentation/devicetree/bindings/regulator/keembay-regulator.yaml
```yaml
# SPDX-License-Identifier: (GPL-2.0-only OR BSD-2-Clause)
%YAML 1.2
---
$id: http://devicetree.org/schemas/regulator/keembay-regulator.yaml#
$schema: http://devicetree.org/meta-schemas/core.yaml#

title: Keem Bay SD regulator

maintainers:
  - Muhammad Husaini Zulkifli <Muhammad.Husaini.Zulkifli@intel.com>

allOf:
  - $ref: "regulator.yaml#"

properties:
  compatible:
    const: regulator-keembay-sd

  regulator-name: true

required:
  - compatible
  - regulator-name

unevaluatedProperties: false

examples:
  - |
    regulator_rail {
      compatible = "regulator-keembay-sd";

      regulator-name = "sd-volt-rail";
      regulator-min-microvolt = <1800000>;
      regulator-max-microvolt = <3300000>;
    };
...
```

## Documentation/devicetree/bindings/reset/intel,thunderbay-reset.yaml
```yaml
# SPDX-License-Identifier: (GPL-2.0 OR BSD-2-Clause)
%YAML 1.2
---
$id: http://devicetree.org/schemas/reset/intel,thunderbay-reset.yaml#
$schema: http://devicetree.org/meta-schemas/core.yaml#

title: Intel, Thunder Bay Peripheral Reset Controller Device Tree Bindings

maintainers:
  - MP Sureshkumar <sureshkumar.mp@intel.com>
  - Shruthi Sanil <shruthi.sanil@intel.com>

properties:
  compatible:
    enum:
      - intel,thunderbay-comss-rst
      - intel,thunderbay-cpuss-rst
      - intel,thunderbay-memss-rst
      - intel,thunderbay-pcie-rst
      - intel,thunderbay-pss-rst1
      - intel,thunderbay-pss-rst2

  reg:
    description: |
      Physical base address and length of Reset registers.
      It contains 4 unsigned 32-bit integer. The first 2 integers
      combine to become an unsigned 64-bit physical address.
      The last 2 integers combine the length of the reset registers memory.
    maxItems: 1

  "#reset-cells":
    const: 1
    description: |
      This additional argument passed to that reset controller is the
      offset of the bit controlling this particular reset line in the
      register.

required:
  - compatible
  - reg
  - "#reset-cells"

additionalProperties: false

examples:
  - |
    rst {
        #address-cells = <2>;
        #size-cells = <2>;

        rst_cpuss: reset-controller@88830040 {
          compatible = "intel,thunderbay-cpuss-rst";
          reg = <0x0 0x88830040 0x0 0x10>;
          #reset-cells = <1>;
        };

        rst_pss1: reset-controller@80430000 {
          compatible = "intel,thunderbay-pss-rst1";
          reg = <0x0 0x80430000 0x0 0x10404>;
          #reset-cells = <1>;
        };

        rst_pss2: reset-controller@80441000 {
          compatible = "intel,thunderbay-pss-rst2";
          reg = <0x0 0x80441000 0x0 0xE004>;
          #reset-cells = <1>;
        };

        rst_pcie: reset-controller@82800000 {
          compatible = "intel,thunderbay-pcie-rst";
          reg = <0x0 0x82800000 0x0 0x10>;
          #reset-cells = <1>;
        };

        rst_comss0: reset-controller@185520000 {
          compatible = "intel,thunderbay-comss-rst";
          reg = <0x1 0x85520000 0x0 0x1010>;
          #reset-cells = <1>;
        };

        rst_comss1: reset-controller@285520000 {
          compatible = "intel,thunderbay-comss-rst";
          reg = <0x2 0x85520000 0x0 0x1010>;
          #reset-cells = <1>;
        };

        rst_comss2: reset-controller@385520000 {
          compatible = "intel,thunderbay-comss-rst";
          reg = <0x3 0x85520000 0x0 0x1010>;
          #reset-cells = <1>;
        };

        rst_comss3: reset-controller@485520000 {
          compatible = "intel,thunderbay-comss-rst";
          reg = <0x4 0x85520000 0x0 0x1010>;
          #reset-cells = <1>;
        };

        rst_memss0_0: reset-controller@184400000 {
          compatible = "intel,thunderbay-memss-rst";
          reg = <0x1 0x84400000 0x0 0x30>;
          #reset-cells = <1>;
        };

        rst_memss0_1: reset-controller@184410000 {
          compatible = "intel,thunderbay-memss-rst";
          reg = <0x1 0x84410000 0x0 0x30>;
          #reset-cells = <1>;
        };

        rst_memss1_0: reset-controller@284400000 {
          compatible = "intel,thunderbay-memss-rst";
          reg = <0x2 0x84400000 0x0 0x30>;
          #reset-cells = <1>;
        };

        rst_memss1_1: reset-controller@284410000 {
          compatible = "intel,thunderbay-memss-rst";
          reg = <0x2 0x84410000 0x0 0x30>;
          #reset-cells = <1>;
        };

        rst_memss2_0: reset-controller@384400000 {
          compatible = "intel,thunderbay-memss-rst";
          reg = <0x3 0x84400000 0x0 0x30>;
          #reset-cells = <1>;
        };

        rst_memss2_1: reset-controller@384410000 {
          compatible = "intel,thunderbay-memss-rst";
          reg = <0x3 0x84410000 0x0 0x30>;
          #reset-cells = <1>;
        };

        rst_memss3_0: reset-controller@484400000 {
          compatible = "intel,thunderbay-memss-rst";
          reg = <0x4 0x84400000 0x0 0x30>;
          #reset-cells = <1>;
        };

        rst_memss3_1: reset-controller@484410000 {
          compatible = "intel,thunderbay-memss-rst";
          reg = <0x4 0x84410000 0x0 0x30>;
          #reset-cells = <1>;
        };
    };
```

## Documentation/devicetree/bindings/soc/intel/intel,keembay-ipc.yaml
```yaml
# SPDX-License-Identifier: (GPL-2.0-only OR BSD-2-Clause)
# Copyright (C) 2020 Intel Corporation
%YAML 1.2
---
$id: "http://devicetree.org/schemas/soc/intel/intel,keembay-ipc.yaml#"
$schema: "http://devicetree.org/meta-schemas/core.yaml#"

title: Keem Bay IPC

maintainers:
  - Daniele Alessandrelli <daniele.alessandrelli@intel.com>

description: |
  The Keem Bay IPC driver enables Inter-Processor Communication (IPC) with the
  Visual Processor Unit (VPU) embedded in the Intel Movidius SoC code named
  Keem Bay.

properties:
  compatible:
    const: intel,keembay-ipc

  reg:
    items:
      - description: The CSS (CPU) FIFO registers
      - description: The MSS (VPU) FIFO registers

  reg-names:
    items:
      - const: css_fifo
      - const: mss_fifo

  interrupts:
    items:
      - description: CSS FIFO not-empty interrupt

  '#interrupt-cells':
    const: 2

  interrupt-controller: true

  memory-region:
    items:
      - description: Reserved memory region used for CSS IPC buffers
      - description: Reserved memory region used for MSS IPC buffers

required:
  - compatible
  - reg
  - reg-names
  - interrupts
  - '#interrupt-cells'
  - memory-region

additionalProperties: false

examples:
  - |
    #include <dt-bindings/interrupt-controller/irq.h>
    #include <dt-bindings/interrupt-controller/arm-gic.h>
    ipc@203300f0 {
          compatible = "intel,keembay-ipc";
          reg = <0x203300f0 0x310>, /* CPU TIM FIFO */
                <0x208200f0 0x310>; /* VPU TIM FIFO */
          reg-names = "css_fifo", "mss_fifo";
          #interrupt-cells = <2>;
          interrupts = <GIC_SPI 12 IRQ_TYPE_LEVEL_HIGH>;
          memory-region = <&css_ipc_reserved>, <&mss_ipc_reserved>;
    };
```
