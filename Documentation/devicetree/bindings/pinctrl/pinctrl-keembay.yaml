## drivers/gpu/drm/hantro_unify/Kconfig
```kconfig
config DRM_HANTRO_UNIFY
	tristate "Hantro Driver Unified"
	depends on DRM
	default m
	select DRM_PANEL
	select DRM_KMS_HELPER
	help
	  Choose this option if your system supports Hantro Driver
	  for KMB B0 and TBH ARM Media. This driver supports video and JPEG
	  encode/decode.
```

## drivers/gpu/drm/i915/Kconfig.chicken
```kconfig
config DRM_I915_CHICKEN_ASYNC_GET_PAGES
	bool "Asynchronous backing store fetch (get_pages)"
	default y
	help
	  Acquire and clear the backing store (chunks of local memory or pages
	  of system memory) in a background thread, returning to userspace
	  without blocking. Access or execution of the object is deferred
	  instead.

config DRM_I915_CHICKEN_PARALLEL_USERPTR
       bool "Parallelised backing store fetch of get_user_pages"
       default y
       help
         Allow the userptr backing store acquire to parallelise its work over
	 multiple threads.

config DRM_I915_CHICKEN_PARALLEL_SHMEMFS
	bool "Parallelised backing store fetch of shmemfs (swapin)"
	default y
	help
	  Allow system memory backing store acquire parallelise its work over
	  multiple threads.

config DRM_I915_CHICKEN_NUMA_ALLOC
	bool "Allocate system memory on the nearest numa node"
	default y
	help
	  Select the numa node nearest to the device for system memory
	  allocations.

config DRM_I915_CHICKEN_CLEAR_ON_CREATE
	bool "Clear backing store immediately upon create"
	default n
	help
	  Queue the clear of all objects at the point of creation (GEM_CREATE
	  ioctl), ahead of first use.

config DRM_I915_CHICKEN_CLEAR_ON_FREE
	bool "Clear backing store on release"
	default y
	help
	  Clear pages on release, ahead of reuse. Only applies to local memory.

config DRM_I915_CHICKEN_CLEAR_ON_IDLE
	bool "Clear backing store on idle (boot)"
	default y
	help
	  Clear local memory on idling, and upon boot.

config DRM_I915_CHICKEN_MMAP_SWAP
	bool "Allow mmap to directly use a swapped out (local memory) object"
	default y
	help
	  Allow userspace to mmap a swapped out object's backing store directly,
	  rather than swapping that object back into local memory.

config DRM_I915_CHICKEN_MMAP_SWAP_CREATE
	bool "Allow mmap to create a swapped out (local memory) object"
	depends on DRM_I915_CHICKEN_MMAP_SWAP
	default y
	help
	  Allow userspace to create a swapped out object.

config DRM_I915_CHICKEN_ULL_DMA_BOOST
	bool "Disable processor C-states to minimise DMA latency"
	default y
	help
	  Set the CPU-DMA latency requirement to 0 to disable processor C-states
	  as we wait for an interrupt on user-fences for ULL compute contexts.

config DRM_I915_CHICKEN_SOFT_PG
	bool "Manually disable/enable powergating around execution"
	default y
	help
	  Powergating is used to put the GT completely asleep by turning the
	  clocks off when idle. This is normally driven by a HW hysteresis
	  monitoring when all engines are idle. However, this can incur a large
	  exit latency delaying the start of subsequeny execution, and in any
	  sitations the client will remain active for the entire duration that
	  the GT is awake, and so we can effectively disable powergating upon
	  wakeup, restoring the power saving when we know all clients are idle.

config DRM_I915_CHICKEN_ASYNC_PAGEFAULTS
	bool "Asynchronous GPU pagefaults"
	default y
	help
	  Process all the background work, such as migration between backing
	  store, waiting for debugger acks and installing the PTE, for a
	  pagefault asynchronously

	  When false, each pagefault will be processed in turn, drip feeding
	  the responses back to the GUC. When true, the pagefault responses
	  (possibly in the 100s) will be sent as soon as they are ready,
	  often faster than the guc is able to process each individual response.
```

## drivers/gpu/drm/i915/fabric/Kconfig
```kconfig
# SPDX-License-Identifier: GPL-2.0-only
config DRM_I915_INTEL_FABRIC
	tristate "Intel Fabric Connectivity driver support"
	depends on 64BIT
	depends on NET
	select LIBCRC32C
	default m
	help
	  This kernel driver provides support for the Intel glueless
	  fabric adapter. The Intel fabric adapter allows GPUs to share
	  device memory space in a device specific address space.

config IAF_DEBUG_ENABLE
	bool "Enable Intel Accelerator Fabric debug configurations"
	depends on DRM_I915_INTEL_FABRIC
	default n
	help
	  Support Intel Accelerator Fabric debug Kconfig options

config IAF_DEBUG_ALTERNATE_FW_LOAD
	bool "Enable Intel Accelerator Fabric load of alternative FW images"
	depends on IAF_DEBUG_ENABLE
	default y
	help
	  Allow fw_image to specify alternate firmware and psc_file_override
	  to load PSC binaries using the FW API instead of SPI flash

config IAF_DEBUG_SELFTESTS
	bool "Enable Intel Accelerator Fabric tests"
	depends on IAF_DEBUG_ENABLE
	default n
	help
	  Enable Intel Accelerator Fabric driver self-tests to be triggered
	  by the 'selftests' module parameter

config IAF_DEBUG_MBOX_ACCESS
	bool "Enable Intel Accelerator Fabric mbox access interface"
	depends on IAF_DEBUG_ENABLE
	default y
	help
	  The mbox interface is an external debug mechanism
	  for supporting debugging of the fabric device firmware

config IAF_DEBUG_STARTUP
	bool "Enable Intel Accelerator Fabric debug startup mode"
	depends on IAF_DEBUG_ENABLE
	default y
	help
	  Allow startup_mode parameter to boot devices into debug modes
```

## drivers/gpu/drm/kmb/Kconfig
```kconfig
config DRM_KMB_DISPLAY
	tristate "KEEMBAY DISPLAY"
	depends on DRM && OF && (ARM || ARM64)
	depends on COMMON_CLK
	select DRM_KMS_HELPER
	select DRM_KMS_CMA_HELPER
	select DRM_GEM_CMA_HELPER
	select VIDEOMODE_HELPERS
	help
	Choose this option if you have an KEEMBAY DISPLAY controller.

	If M is selected the module will be called kmb-display.
```

## drivers/hwtracing/intel_th/Kconfig
```kconfig
config INTEL_TH
	tristate "Intel(R) Trace Hub controller"
	depends on HAS_DMA && HAS_IOMEM
	help
	  Intel(R) Trace Hub (TH) is a set of hardware blocks (subdevices) that
	  produce, switch and output trace data from multiple hardware and
	  software sources over several types of trace output ports encoded
	  in System Trace Protocol (MIPI STPv2) and is intended to perform
	  full system debugging.

	  This option enables intel_th bus and common code used by TH
	  subdevices to interact with each other and hardware and for
	  platform glue layers to drive Intel TH devices.

	  Say Y here to enable Intel(R) Trace Hub controller support.

if INTEL_TH

config INTEL_TH_PCI
	tristate "Intel(R) Trace Hub PCI controller"
	depends on PCI
	help
	  Intel(R) Trace Hub may exist as a PCI device. This option enables
	  support glue layer for PCI-based Intel TH.

	  Say Y here to enable PCI Intel TH support.

config INTEL_TH_ACPI
	tristate "Intel(R) Trace Hub ACPI controller"
	depends on ACPI
	help
	  Intel(R) Trace Hub may exist as an ACPI device. This option enables
	  support glue layer for ACPI-based Intel TH. This typically implies
	  'host debugger' mode, that is, the trace configuration and capture
	  is handled by an external debug host and corresponding controls will
	  not be available on the target.

	  Say Y here to enable ACPI Intel TH support.

config INTEL_TH_GTH
	tristate "Intel(R) Trace Hub Global Trace Hub"
	help
	  Global Trace Hub (GTH) is the central component of the
	  Intel TH infrastructure and acts as a switch for source
	  and output devices. This driver is required for other
	  Intel TH subdevices to initialize.

	  Say Y here to enable GTH subdevice of Intel(R) Trace Hub.

config INTEL_TH_STH
	tristate "Intel(R) Trace Hub Software Trace Hub support"
	depends on STM
	help
	  Software Trace Hub (STH) enables trace data from software
	  trace sources to be sent out via Intel(R) Trace Hub. It
	  uses stm class device to interface with its sources.

	  Say Y here to enable STH subdevice of Intel(R) Trace Hub.

config INTEL_TH_MSU
	tristate "Intel(R) Trace Hub Memory Storage Unit"
	help
	  Memory Storage Unit (MSU) trace output device enables
	  storing STP traces to system memory. It supports single
	  and multiblock modes of operation and provides read()
	  and mmap() access to the collected data.

	  Say Y here to enable MSU output device for Intel TH.

config INTEL_TH_MSU_DVC
        tristate "Intel Trace Hub Memory Storage Unit to USB-dvc"
	help
	  Memory Storage Unit (MSU) trace output device enables
	  storing STP traces to system memory.
	  This provides the means to route this data over USB,
	  using DvC-Trace.

	  Say Y here to enable DvC-Trace output device for Intel TH.

config INTEL_TH_MSU_DVC_DEBUG
        tristate "Intel Trace Hub Memory Storage Unit to USB-dvc debug"
	help
	  Memory Storage Unit (MSU) trace output device enables
	  storing STP traces to system memory.
	  This enables extensive logging and collection of
	  statistical data on MSU/DvC-Trace device performance.

	  Say Y to enable extended debug features on MSU-DvC.

config INTEL_TH_PTI
	tristate "Intel(R) Trace Hub PTI output"
	help
	  Parallel Trace Interface unit (PTI) is a trace output device
	  of Intel TH architecture that facilitates STP trace output via
	  a PTI port.

	  Say Y to enable PTI output of Intel TH data.

config INTEL_TH_DEBUG
	bool "Intel(R) Trace Hub debugging"
	depends on DEBUG_FS
	help
	  Say Y here to enable debugging.

config INTEL_TH_EARLY_PRINTK
	bool "Intel TH early printk console"
	depends on INTEL_TH=y
	default n
	---help---
	  Enables early printk console.
	  When the early printk console is enabled in the kernel
	  command line, kernel log messages are sent to Intel TH
	  (hence they are aggregated with the other trace messages
	  from the platform).

endif
```

## drivers/interconnect/intel/Kconfig
```kconfig
# Copyright (C) 2019 Intel Corporation
# SPDX-License-Identifier: GPL-2.0-only
config INTERCONNECT_INTEL
	bool "Intel Network-on-chip interconnect drivers"
	help
	  Support for Intel's Network on chip interconnect hardware.

config INTERCONNECT_INTEL_KEEMBAY
	tristate "Intel Keem Bay Enable DDR profiling using NOC"
	depends on INTERCONNECT_INTEL || ARCH_KEEMBAY || COMPILE_TEST
	help
	  Enable this option for DDR bandwidth measurements using NOC.

	  Add support for Network-on-chip (NOC) in DDR Subsystem(DSS).
	  DSS NOC has capabilities to enable and get statistics profiling.
	  NOC driver enables features to configure and capture NOC probe
	  counters, needed for DSS bandwidth measurement.
	  Say Y if using a processor that includes the Intel VPU such as
	  Keem Bay.  If unsure, say N.
```

## drivers/media/i2c/crlmodule/Kconfig
```kconfig
config VIDEO_CRLMODULE
	tristate "CRL Module sensor support"
	depends on I2C
    depends on VIDEO_V4L2
    depends on VIDEO_V4L2_SUBDEV_API
	depends on MEDIA_CAMERA_SUPPORT
    select V4L2_ASYNC
	help
	  This is a generic driver for CRL based camera modules.
```

## drivers/media/i2c/ici/Kconfig
```kconfig
if VIDEO_INTEL_ICI

menu "Deserializers for ICI"

config VIDEO_TI964_ICI
	tristate "TI964 driver support"
	depends on I2C && VIDEO_INTEL_ICI
	---help---
	This is a driver for TI964 camera for ICI.

config VIDEO_MAX9286_ICI
	tristate "MAX9286 driver support"
	depends on I2C && VIDEO_INTEL_ICI
	---help---
	This is a driver for MAX9286 camera for ICI.

endmenu

endif
```

## drivers/media/pci/intel-ipu4/Kconfig
```kconfig
config VIDEO_INTEL_IPU4
	tristate "Intel intel-ipu4 driver"
	depends on ACPI && X86_64
	select IOMMU_API
	select IOMMU_IOVA
	select X86_DEV_DMA_OPS if X86
	select VIDEOBUF2_DMA_CONTIG
	select PHYS_ADDR_T_64BIT
	select COMMON_CLK
	---help---
	Select for intel-ipu4 controller

choice
	prompt "intel-ipu4 hardware type"
	depends on VIDEO_INTEL_IPU4
	default VIDEO_INTEL_IPU4_SOC

config VIDEO_INTEL_IPU4_SOC
	bool "Compile for SOC"

endchoice

config VIDEO_INTEL_IPU_FW_LIB
	bool "Compile firmware library"

#config VIDEO_INTEL_IPU4_DEBUG
#	tristate "User space interface for firmware testing"
#	depends on VIDEO_INTEL_IPU4
```

## drivers/media/pci/intel/Kconfig
```kconfig
config VIDEO_INTEL_IPU6
	tristate "Intel IPU driver"
	depends on ACPI
	depends on MEDIA_SUPPORT
	depends on MEDIA_PCI_SUPPORT
	select IOMMU_API
	select IOMMU_IOVA
	select X86_DEV_DMA_OPS if X86
	select VIDEOBUF2_DMA_CONTIG
	select V4L2_FWNODE
	select PHYS_ADDR_T_64BIT
	select COMMON_CLK
	help
	  This is the Intel imaging processing unit, found in Intel SoCs and
	  used for capturing images and video from a camera sensor.

	  To compile this driver, say Y here! It contains 3 modules -
	  intel_ipu*, intel_ipu*_isys and intel_ipu*_psys.

choice
	prompt "intel ipu hardware platform type"
	depends on VIDEO_INTEL_IPU6
	default VIDEO_INTEL_IPU_SOC

config VIDEO_INTEL_IPU_SOC
	bool "Compile for SOC"
	help
	  Used for real SoC hardware driver development
	  Select for SOC platform

endchoice

config VIDEO_INTEL_IPU_WERROR
	bool "Force GCC to throw an error instead of a warning when compiling"
	depends on VIDEO_INTEL_IPU6
	depends on EXPERT
	depends on !COMPILE_TEST
	default n
	help
	  Add -Werror to the build flags for (and only for) intel ipu module.
	  Do not enable this unless you are writing code for the ipu module.

	  Recommended for driver developers only.

	  If in doubt, say "N".

config VIDEO_INTEL_IPU_USE_PLATFORMDATA
	bool "Enable platform data"
	depends on VIDEO_INTEL_IPU6
	default y
	help
	  Enalbe platform data in IPU.

config VIDEO_INTEL_IPU_PDATA_DYNAMIC_LOADING
	bool "Enable platform data dynamic loading"
	depends on VIDEO_INTEL_IPU6
	depends on VIDEO_INTEL_IPU_USE_PLATFORMDATA
	default n
	help
	  Load sensor configuration data from file system. Then if there's hardware
	  configuration change no need to recompile the kernel. Useful in multiple port
	  and multiple sensor case

	  If in doubt, say "N".
```

## drivers/media/platform/intel/Kconfig
```kconfig
config INTEL_IPU6_TGLRVP_PDATA
	bool "Enable built in platform data for TGL RVP"
	depends on MEDIA_CAMERA_SUPPORT
	help
	Pre-ACPI system platform data is compiled inside kernel

config INTEL_IPU6_ADLRVP_PDATA
	bool "Enable built in platform data for ADL RVP"
	depends on MEDIA_CAMERA_SUPPORT
	help
	 Pre-ACPI system platform data is compiled inside kernel

	 This platform data is useful for software development before
	 the SOC system not ready.

config INTEL_IPU6_ACPI
	tristate "Enable IPU ACPI driver"
	depends on I2C
	depends on ACPI
	depends on INTEL_SKL_INT3472
	help
	Driver to read ACPI data from BIOS

	This driver is used to read ACPI data from BIOS
```
