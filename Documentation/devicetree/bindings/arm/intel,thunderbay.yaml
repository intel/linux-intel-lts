## Documentation/devicetree/bindings/arm/intel,thunderbay.yaml
```yaml
# SPDX-License-Identifier: (GPL-2.0-only OR BSD-2-Clause)
%YAML 1.2
---
$id: http://devicetree.org/schemas/arm/intel,thunderbay.yaml#
$schema: http://devicetree.org/meta-schemas/core.yaml#

title: Thunder Bay platform device tree bindings

maintainers:
  - Kenchappa, Demakkanavar <kenchappa.demakkanavar@intel.com>

properties:
  $nodename:
    const: '/'
  compatible:
    items:
      - enum:
          - intel,thunderbay-s02
          - intel,thunderbay-s03
          - intel,thunderbay-s12
          - intel,thunderbay-s13
          - intel,thunderbay-full
      - const: intel,thunderbay-hddl

additionalProperties: true

...
```

## Documentation/devicetree/bindings/clock/ti,cdcun1208.yaml
```yaml
# SPDX-License-Identifier: (GPL-2.0 OR BSD-2-Clause)
# Copyright 2020 Intel Corporation
%YAML 1.2
---
$id: "http://devicetree.org/schemas/clock/ti,cdcun1208.yaml#"
$schema: "http://devicetree.org/meta-schemas/core.yaml#"

title: TI CDCUN1208 Clock Buffer

maintainers:
  - Daniele Alessandrelli <daniele.alessandrelli@intel.com>

description: |
  CDCUN1208 is a 2:8 fan-out buffer.

properties:
  compatible:
    const: ti,cdcun1208

  reg:
    items:
      - description: i2c device address

  clocks:
    items:
      - description: Input clock

  clock-names:
    items:
      - const: gpio-out-clk

  '#clock-cells':
    const: 1
    description: |
      The clock consumer should specify the desired clock by having the clock
      ID in its "clocks" phandle cell. See
      include/dt-bindings/clock/ti,cdcun1208.h for the full list of CDCUN1208
      clock IDs.

  supply-out-clk:
    description: A regulator node for Vdd

required:
  - compatible
  - reg
  - clocks
  - clock-names
  - '#clock-cells'

examples:
  - |
    #include <dt-bindings/clock/ti,cdcun1208.h>

    out_24Mhz: out_24Mhz {
            #clock-cells = <0>;
            compatible = "fixed-clock";
            clock-frequency = <24000000>;
    };

    i2c0 {
            #address-cells = <1>;
            #size-cells = <0>;
            cdcun_1208: cdcun_1208@28 {
                    #clock-cells = <1>;
                    reg = <0x28>;
                    compatible = "ti,cdcun1208";
                    clock-names = "gpio-out-clk";
                    clocks = <&out_24Mhz>;
            };
    };

    // Clock consumer node
    foo@0 {
            compatible = "bar,foo";
            /* ... */
            clock-names = "clkout1";
            clocks = <&cdcun_1208 CDCUN_1208_OUT1>;
    };
```

## Documentation/devicetree/bindings/crypto/intel,keembay-ocs-aes.yaml
```yaml
# SPDX-License-Identifier: (GPL-2.0-only OR BSD-2-Clause)
%YAML 1.2
---
$id: http://devicetree.org/schemas/crypto/intel,keembay-ocs-aes.yaml#
$schema: http://devicetree.org/meta-schemas/core.yaml#

title: Keem Bay OCS AES Device Tree Bindings

maintainers:
  - Paul Murphy <paul.j.murphy@intel.com>

description: |
  The Keem Bay Offload and Crypto Subsystem (OCS) AES driver enables
  use of the hardware accelerated crypto module, embedded in the
  Intel Movidius SoC code name Keem Bay, via the kernel crypto API.

properties:
  compatible:
    const: intel,keembay-ocs-aes

  reg:
    items:
      - description: The OCS AES base register address

  interrupts:
    items:
      - description: OCS AES interrupt

  clocks:
    items:
      - description: OCS clock

required:
  - compatible
  - reg
  - interrupts
  - clocks

additionalProperties: false

examples:
  - |
    #include <dt-bindings/interrupt-controller/arm-gic.h>
    #define KEEM_BAY_PSS_AUX_OCS
    aes {
      compatible = "intel,keembay-ocs-aes";
      reg = <0x0 0x30008000 0x0 0x1000>;
      interrupts = <GIC_SPI 114 IRQ_TYPE_LEVEL_HIGH>;
      clocks = <&scmi_clk KEEM_BAY_PSS_AUX_OCS>;
    };

...
```

## Documentation/devicetree/bindings/crypto/intel,keembay-ocs-ecc.yaml
```yaml
# SPDX-License-Identifier: (GPL-2.0-only OR BSD-2-Clause)
%YAML 1.2
---
$id: http://devicetree.org/schemas/crypto/intel,keembay-ocs-ecc.yaml#
$schema: http://devicetree.org/meta-schemas/core.yaml#

title: Keem Bay OCS ECC Device Tree Bindings

maintainers:
  - Paul Murphy <paul.j.murphy@intel.com>

description: |
  The Keem Bay Offload and Crypto Subsystem (OCS) ECC driver enables
  use of the hardware accelerated crypto module, embedded in the
  Intel Movidius SoC code name Keem Bay, via the kernel crypto API.

properties:
  compatible:
    const: intel,keembay-ocs-ecc

  reg:
    items:
      - description: The OCS ECC base register address

  interrupts:
    items:
      - description: OCS ECC interrupt

  clocks:
    items:
      - description: OCS clock

required:
  - compatible
  - reg
  - interrupts
  - clocks

additionalProperties: false

examples:
  - |
    #include <dt-bindings/interrupt-controller/arm-gic.h>
    #define KEEM_BAY_PSS_AUX_OCS
    ecc {
      compatible = "intel,keembay-ocs-ecc";
      reg = <0x30001000 0x1000>;
      interrupts = <GIC_SPI 120 IRQ_TYPE_LEVEL_HIGH>;
      clocks = <&scmi_clk KEEM_BAY_PSS_AUX_OCS>;
    };

...
```

## Documentation/devicetree/bindings/crypto/intel,keembay-ocs-hcu.yaml
```yaml
# SPDX-License-Identifier: (GPL-2.0-only OR BSD-2-Clause)
%YAML 1.2
---
$id: http://devicetree.org/schemas/crypto/intel,keembay-ocs-hcu.yaml#
$schema: http://devicetree.org/meta-schemas/core.yaml#

title: Keem Bay OCS HCU Device Tree Bindings

maintainers:
  - Paul Murphy <paul.j.murphy@intel.com>

description: |
  The Keem Bay Offload and Crypto Subsystem (OCS) HCU driver enables
  use of the hardware accelerated hashing module, embedded in the
  Intel Movidius SoC code name Keem Bay, via the kernel crypto API.

properties:
  compatible:
    const: intel,keembay-ocs-hcu

  reg:
    items:
      - description: The OCS HCU base register address

  interrupts:
    items:
      - description: OCS HCU interrupt

  clocks:
    items:
      - description: OCS clock

required:
  - compatible
  - reg
  - interrupts
  - clocks

additionalProperties: false

examples:
  - |
    #include <dt-bindings/interrupt-controller/arm-gic.h>
    #define KEEM_BAY_PSS_AUX_OCS
    hcu {
      compatible = "intel,keembay-ocs-hcu";
      reg = <0x0 0x3000b000 0x0 0x1000>;
      interrupts = <GIC_SPI 121 IRQ_TYPE_LEVEL_HIGH>;
      clocks = <&scmi_clk KEEM_BAY_PSS_AUX_OCS>;
    };

...
```

## Documentation/devicetree/bindings/firmware/intel,keembay-vpu-ipc.yaml
```yaml
# SPDX-License-Identifier: (GPL-2.0 OR BSD-2-Clause)
# Copyright (c) Intel Corporation. All rights reserved.
%YAML 1.2
---
$id: "http://devicetree.org/schemas/firmware/intel,keembay-vpu-ipc.yaml#"
$schema: "http://devicetree.org/meta-schemas/core.yaml#"

title: Intel Keem Bay VPU IPC

maintainers:
  - Paul Murphy <paul.j.murphy@intel.com>

description: |
  The VPU IPC driver facilitates loading of firmware, control, and communication
  with the VPU over the IPC FIFO in the Intel Keem Bay SoC.

properties:
  compatible:
    oneOf:
      - items:
        - const: intel,keembay-vpu-ipc

  reg:
    items:
      - description: NCE WDT registers
      - description: NCE TIM_GEN_CONFIG registers
      - description: MSS WDT registers
      - description: MSS TIM_GEN_CONFIG registers

  reg-names:
    items:
      - const: nce_wdt
      - const: nce_tim_cfg
      - const: mss_wdt
      - const: mss_tim_cfg

  memory-region:
    items:
      - description: reference to the VPU reserved memory region
      - description: reference to the X509 reserved memory region
      - description: reference to the MSS IPC area

  clocks:
    items:
      - description: cpu clock
      - description: pll 0 out 0 rate
      - description: pll 0 out 1 rate
      - description: pll 0 out 2 rate
      - description: pll 0 out 3 rate
      - description: pll 1 out 0 rate
      - description: pll 1 out 1 rate
      - description: pll 1 out 2 rate
      - description: pll 1 out 3 rate
      - description: pll 2 out 0 rate
      - description: pll 2 out 1 rate
      - description: pll 2 out 2 rate
      - description: pll 2 out 3 rate

  clocks-names:
    items:
      - const: cpu_clock
      - const: pll_0_out_0
      - const: pll_0_out_1
      - const: pll_0_out_2
      - const: pll_0_out_3
      - const: pll_1_out_0
      - const: pll_1_out_1
      - const: pll_1_out_2
      - const: pll_1_out_3
      - const: pll_2_out_0
      - const: pll_2_out_1
      - const: pll_2_out_2
      - const: pll_2_out_3

  interrupts:
    items:
      - description: number of NCE sub-system WDT timeout IRQ
      - description: number of MSS sub-system WDT timeout IRQ

  interrupt-names:
    items:
      - const: nce_wdt
      - const: mss_wdt

  intel,keembay-vpu-ipc-nce-wdt-redirect:
    $ref: "/schemas/types.yaml#/definitions/uint32"
    description:
      Number to which we will request that the NCE sub-system
      re-directs it's WDT timeout IRQ

  intel,keembay-vpu-ipc-mss-wdt-redirect:
    $ref: "/schemas/types.yaml#/definitions/uint32"
    description:
      Number to which we will request that the MSS sub-system
      re-directs it's WDT timeout IRQ

  intel,keembay-vpu-ipc-imr:
    $ref: "/schemas/types.yaml#/definitions/uint32"
    description:
      IMR (isolated memory region) number which we will request
      the runtime service uses to protect the VPU memory region
      before authentication

  intel,keembay-vpu-ipc-id:
    $ref: "/schemas/types.yaml#/definitions/uint32"
    description: The ID uniquely identifying the VPU within the SoC.

examples:
  - |
    #include <dt-bindings/interrupt-controller/arm-gic.h>
    vpu-ipc {
        compatible = "intel,keembay-vpu-ipc";
        reg = <0x0 0x3f00209c 0x0 0x10>,
              <0x0 0x3f003008 0x0 0x4>,
              <0x0 0x2082009c 0x0 0x10>,
              <0x0 0x20821008 0x0 0x4>;
        reg-names = "nce_wdt",
                    "nce_tim_cfg",
                    "mss_wdt",
                    "mss_tim_cfg";
        memory-region = <&vpu_reserved>,
                        <&vpu_x509_reserved>,
                        <&mss_ipc_reserved>;
        clocks = <&scmi_clk 0>,
                 <&scmi_clk 0>,
                 <&scmi_clk 1>,
                 <&scmi_clk 2>,
                 <&scmi_clk 3>,
                 <&scmi_clk 4>,
                 <&scmi_clk 5>,
                 <&scmi_clk 6>,
                 <&scmi_clk 7>,
                 <&scmi_clk 8>,
                 <&scmi_clk 9>,
                 <&scmi_clk 10>,
                 <&scmi_clk 11>;
        clock-names = "cpu_clock",
                      "pll_0_out_0", "pll_0_out_1",
                      "pll_0_out_2", "pll_0_out_3",
                      "pll_1_out_0", "pll_1_out_1",
                      "pll_1_out_2", "pll_1_out_3",
                      "pll_2_out_0", "pll_2_out_1",
                      "pll_2_out_2", "pll_2_out_3";
        interrupts = <GIC_SPI 63 IRQ_TYPE_LEVEL_HIGH>,
                     <GIC_SPI 47 IRQ_TYPE_LEVEL_HIGH>;
        interrupt-names = "nce_wdt", "mss_wdt";
        intel,keembay-vpu-ipc-nce-wdt-redirect = <63>;
        intel,keembay-vpu-ipc-mss-wdt-redirect = <47>;
        intel,keembay-vpu-ipc-imr = <9>;
        intel,keembay-vpu-ipc-id = <0>;
    };
```

## Documentation/devicetree/bindings/mailbox/intel,keembay-scmi-mailbox.yaml
```yaml
# SPDX-License-Identifier: (GPL-2.0-only OR BSD-2-Clause)
# Copyright (c) 2020 Intel Corporation
%YAML 1.2
---
$id: "http://devicetree.org/schemas/mailbox/intel,keembay-scmi-mailbox.yaml#"
$schema: "http://devicetree.org/meta-schemas/core.yaml#"

title: Intel Keem Bay SCMI mailbox

maintainers:
  - Paul Murphy <paul.j.murphy@intel.com>

description: |
  The Intel Keem Bay SCMI mailbox is used to communicate SCMI messages to the
  runtime service in BL31 behaving as the SCMI 'SCP'.
  Refer to ./mailbox.txt for generic information about mailbox device-tree
  bindings.
  For more information about SCMI, refer to the bindings described in
  Documentation/devicetree/bindings/arm/arm,scmi.txt

properties:
  compatible:
    enum:
      - intel,keembay-scmi-mailbox

  "#mbox-cells":
    const: 1

  memory-region:
    description:
      Memory region describing the SCMI shared memory

required:
  - compatible
  - "#mbox-cells"
  - memory-region

examples:
  - |
    scmi_mailbox: scmi_mailbox {
        compatible = "intel,keembay-scmi-mailbox";
        #mbox-cells = <1>;
        memory-region = <&scmi_sec_shmem>;
    };
```

## Documentation/devicetree/bindings/media/i2c/intel,kmb-camera-flash.yaml
```yaml
# SPDX-License-Identifier: (GPL-2.0-only OR BSD-2-Clause)
# Copyright (C) 2020 Intel Corporation
%YAML 1.2
---
$id: http://devicetree.org/schemas/media/i2c/intel,kmb-camera-flash.yaml#
$schema: http://devicetree.org/meta-schemas/core.yaml#

title: Keem Bay flash

maintainers:
  - Daniele Alessandrelli <daniele.alessandrelli@intel.com>

properties:
  compatible:
    oneOf:
      - items:
        - const: intel,kmb-camera-flash

  reg:
    items:
      - description: I2C address (0x24, or an alternative address)

required:
  - compatible
  - reg

examples:
  - |
    i2c {
        #address-cells = <1>;
        #size-cells = <0>;
        kmb_flash: flash@24 {
              compatible = "intel,kmb-camera-flash";
              reg = <0x24>;
        };
    };
```

## Documentation/devicetree/bindings/media/i2c/intel,kmb-camera-lens.yaml
```yaml
# SPDX-License-Identifier: (GPL-2.0-only OR BSD-2-Clause)
# Copyright (C) 2020 Intel Corporation
%YAML 1.2
---
$id: http://devicetree.org/schemas/media/i2c/intel,kmb-camera-lens.yaml#
$schema: http://devicetree.org/meta-schemas/core.yaml#

title: Keem Bay lens

maintainers:
  - Daniele Alessandrelli <daniele.alessandrelli@intel.com>

properties:
  compatible:
    oneOf:
      - items:
        - const: intel,kmb-camera-lens

  reg:
    items:
      - description: I2C address (0x61, or an alternative address)

required:
  - compatible
  - reg

examples:
  - |
    i2c {
        #address-cells = <1>;
        #size-cells = <0>;
        kmb_lens: lens@61 {
              compatible = "intel,kmb-camera-lens";
              reg = <0x61>;
        };
    };
```
