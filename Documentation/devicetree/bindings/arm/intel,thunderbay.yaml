## Documentation/devicetree/bindings/media/i2c/intel,kmb-camera-sensor.yaml
```yaml
# SPDX-License-Identifier: (GPL-2.0-only OR BSD-2-Clause)
# Copyright (C) 2020 Intel Corporation
%YAML 1.2
---
$id: http://devicetree.org/schemas/media/i2c/intel,kmb-camera-sensor.yaml#
$schema: http://devicetree.org/meta-schemas/core.yaml#

title: Keem Bay Sensor

maintainers:
  - Daniele Alessandrelli <daniele.alessandrelli@intel.com>

description: |-
  The Keem Bay Sensor is a dummy device driver used for memory to memory
  processing.

properties:
  compatible:
    oneOf:
      - items:
        - const: intel,kmb-camera-sensor
  reg:
    description: I2C address
    maxItems: 1

  # See ../video-interfaces.txt for more details
  flash-leds:
    description: See ../video-interfaces.txt
  lens-focus:
    description: See ../video-interfaces.txt
  port:
    type: object
    properties:
      endpoint:
        type: object
        properties:
          data-lanes:
              description: See ../video-interfaces.txt
          clock-lanes:
              description: See ../video-interfaces.txt
          link-frequencies:
            $ref: /schemas/types.yaml#/definitions/uint64-array
            description: See ../video-interfaces.txt
          remote-endpoint:
              description: See ../video-interfaces.txt

        required:
          - data-lanes
          - clock-lanes
          - link-frequencies

required:
  - compatible
  - reg
  - port

examples:
  - |
    i2c0 {
        #address-cells = <1>;
        #size-cells = <0>;
        kmb-camera-sensor {
            compatible = "intel,kmb-camera-sensor";
            reg = <0x57>;

            lens-focus = <&kmb_lens>;
            flash-leds = <&kmb_flash>;

            port {
                kmb_sen_i2c: endpoint {
                  remote-endpoint = <&cam>;
                  link-frequencies = /bits/ 64 <210000000>;
                  clock-lanes = <0>;
                  data-lanes = <1 2 3 4>;
                };
            };
        };
    };
```

## Documentation/devicetree/bindings/media/i2c/intel,kmb-imx327-sensor.yaml
```yaml
# SPDX-License-Identifier: (GPL-2.0-only OR BSD-2-Clause)
# Copyright (C) 2020 Intel Corporation
%YAML 1.2
---
$id: http://devicetree.org/schemas/media/i2c/intel,kmb-imx327-sensor.yaml#
$schema: http://devicetree.org/meta-schemas/core.yaml#

title: Keem Bay IMX327 Sensor

maintainers:
  - Daniele Alessandrelli <daniele.alessandrelli@intel.com>

description: |-
  The Keem Bay imx327 sensor is a Sony CMOS active pixel digital image sensor
  with an active array size of 1937H x 1097V. It is programmable through I2C
  interface. The I2C address is fixed to 0x1a as per sensor data sheet.  Image
  data is sent through MIPI CSI-2, which is configured as 4 lanes at 222.75
  Mbps.

  The sensor can also be probed as platform device and later on registered
  to the I2C bus. Probing as platform device is used when different
  sensors with the same slave address must be able to be attached to one slot.
  They are probed with priority. Example slot with multiple sensors attached



properties:
  compatible:
    oneOf:
      - items:
        - const: intel,kmb-imx327-sensor
      - items:
        - const: intel,kmb-imx327-sensor-p
  reg:
    description: I2C address
    maxItems: 1

  # See ../video-interfaces.txt for more details
  flash-leds:
    description: See ../video-interfaces.txt
  lens-focus:
    description: See ../video-interfaces.txt
  port:
    type: object
    properties:
      endpoint:
        type: object
        properties:
          data-lanes:
              description: See ../video-interfaces.txt
          clock-lanes:
              description: See ../video-interfaces.txt
          link-frequencies:
            $ref: /schemas/types.yaml#/definitions/uint64-array
            description: See ../video-interfaces.txt
          remote-endpoint:
              description: See ../video-interfaces.txt

        required:
          - link-frequencies

required:
  - compatible
  - port



examples:
  - |
    i2c0 {
          #address-cells = <1>;
          #size-cells = <0>;
          label = "LS-I2C1";

          kmb-camera-sensor {
                reg = <0x1A>;
                compatible = "intel,kmb-imx327-sensor";
                port {
                      kmb_sen_i2c:endpoint {
                            remote-endpoint = <&cam>;
                            link-frequencies =
                                  /bits/ 64 <199200000 210000000 499200000>;
                            clock-lanes = <0>;
                            data-lanes = <1 2 3 4>;
                      };
                };
          };
    };
  - |
    #include <dt-bindings/gpio/gpio.h>
    keembay_cam_a {
          #address-cells = <1>;
          #size-cells = <0>;
          compatible = "intel,kmb-imx327-sensor-p";
          i2c-bus = <&i2c1>;
          lens-focus = <&kmb_lens2>;
          flash-leds = <&kmb_flash2>;
          eeprom = <&cama_eeprom>;

          reset-gpios = <&pca0 6 GPIO_ACTIVE_HIGH>;

          detect-gpios = <&pca1 17 GPIO_ACTIVE_HIGH>,
                <&pca1 6 GPIO_ACTIVE_HIGH>,
                <&pca1 16 GPIO_ACTIVE_HIGH>;
          clock-names = "inclk";
          clocks = <&kmb_clock_buff 0x0>;

          port {
                cam_a: endpoint {
                      remote-endpoint = <&cam0>;
                      link-frequencies = /bits/ 64 <210000000>;
                      clock-lanes = <0>;
                      data-lanes = <1 2 3 4>;
                };
          };
    };
```

## Documentation/devicetree/bindings/media/intel,keembay-camera.yaml
```yaml
# SPDX-License-Identifier: (GPL-2.0-only OR BSD-2-Clause)
# Copyright (C) 2020 Intel Corporation
%YAML 1.2
---
$id: http://devicetree.org/schemas/media/intel,keembay-camera.yaml#
$schema: http://devicetree.org/meta-schemas/core.yaml#

title: Intel Keem Bay camera subsystem

maintainers:
  - Daniele Alessandrelli <daniele.alessandrelli@intel.com>

properties:
  compatible:
    oneOf:
      - items:
        - const: intel,camera-sensor

  # See ./video-interfaces.txt for more details
  port:
    type: object
    properties:
      endpoint:
        type: object
        properties:
          reg:
            description: MIPI receiver index
            maxItems: 1
          data-lanes:
              description: See ./video-interfaces.txt
          clock-lanes:
              description: See ./video-interfaces.txt
          link-frequencies:
            $ref: /schemas/types.yaml#/definitions/uint64-array
            description: See ./video-interfaces.txt
          remote-endpoint:
              description: See ./video-interfaces.txt
          lane-polarities:
              description: See ./video-interfaces.txt

        required:
          - reg
          - data-lanes
          - clock-lanes

required:
  - compatible
  - port

examples:
  - |
    keembay_camera {
          #address-cells = <1>;
          #size-cells = <1>;
          compatible = "intel,kmb-camera";
          port {
                #address-cells = <1>;
                #size-cells = <0>;

                cam0: endpoint@4 {
                      reg = <0x4>;
                      remote-endpoint = <&cam_a>;
                      crc = <1>;
                      lane-polarities = <1 1 1 1 1>;
                      data-lanes = <1 2 3 4>;
                      clock-lanes = <0>;
                };

                cam9: endpoint@0 {
                      reg = <0x0>;
                      remote-endpoint = <&kmb_sen_i2c>;
                      crc = <1>;
                      lane-polarities = <1 1 1 1 1>;
                      data-lanes = <1 2 3 4>;
                      clock-lanes = <0>;
                };
          };
    };
```

## Documentation/devicetree/bindings/misc/intel,hddl-client.txt
```
Intel HDDL client
---------------------

The hddl client driver enables reading of onchip sensors present
in the Intel Bay SoC.

Required properties:
- compatible : "intel,hddl-client"

- reg: list of register areas, as specified in reg-names
- interrupts: not used
- clocks: clock needed for thermal to operate

Example:
	hddl_dev: hddl_device {
		compatible = "intel,hddl-client";
		status = "disabled";
		reg = <0x0 0x20320000 0x0 0x800>;
		xlink_chan = <1080>;
		i2c_xlink_chan = <1081>;
		kmb_xlink_tj@5a {
			status = "okay";
			compatible = "intel_tsens";
			reg = <0x4000005a>;
			local-host = <0x3>;
			remote-host = <0x3>;
			bus = <0x1>;
		};
	};
```

## Documentation/devicetree/bindings/misc/intel,hddl-client.yaml
```yaml
# SPDX-License-Identifier: (GPL-2.0-only OR BSD-2-Clause)
%YAML 1.2
---
$id: "http://devicetree.org/schemas/misc/intel,hddl-client.yaml#"
$schema: "http://devicetree.org/meta-schemas/core.yaml#"

title: Intel hddl client device to handle platform management in Bay series

maintainers:
  - Udhayakumar C <udhayakumar.c@intel.com>

description: |
  The HDDL client driver acts as an software RTC to sync with network time.
  It abstracts xlink protocol to communicate with remote host. This driver
  exports the details about sensors available in the platform to remote
  host as xlink packets.
  This driver also handles device connect/disconnect events and identifies
  board id and soc id using gpio's based on platform configuration.

select: false

properties:
  compatible:
    items:
      - const: intel,hddl-client

  reg:
    minItems: 4
    maxItems: 4

  xlink_chan:
    minItems: 1
    maxItems: 1
    description: xlink channel number used for communication
                 with remote host for time sync and sharing sensor
                 details available in platform.

  i2c_xlink_chan:
    minItems: 1
    maxItems: 1
    description: xlink channel number used for communication
                 with remote host for xlink i2c smbus.

  sensor_name:
    type: object
    description:
      Details about sensors and its configuration on local host and remote
      host.

    properties:
      compatible:
        items:
          - const: intel_tsens

      reg:
        description: i2c slave address for sensor.

      local-host:
        minItems: 1
        maxItems: 1
        description: enable bit 0 to register sensor as i2c slave
                     in local host (normal i2c client)
                     enable bit 1 to mimic sensor as i2c slave
                     in local host (onchip sensors as i2c slave)
                     enable bit 2 to register i2c slave as xlink smbus slave
                     in local host.
      remote-host:
        minItems: 1
        maxItems: 1
        description: enable bit 0 to register sensor as i2c slave
                     in remote host (normal i2c client)
                     enable bit 1 to mimic sensor as i2c slave
                     in remote host (onchip sensors as i2c slave)
                     enable bit 2 to register i2c slave as xlink smbus slave
                     in remote host.

      bus:
        minItems: 1
        maxItems: 1
        description: i2c bus number for the i2c client device.

    required:
      - compatible
      - reg
      - local-host
      - remote-host
      - bus

required:
  - compatible
  - reg
  - xlink_chan
  - i2c_xlink_chan

additionalProperties: false

examples:
  - |
    hddl_dev: hddl@20320000 {
       compatible = "intel,hddl-client";
       #address-cells = <2>;
       #size-cells = <2>;
       status = "disabled";
       reg = <0x0 0x20320000 0x0 0x800>;
       xlink_chan = <1080>;
       i2c_xlink_chan = <1081>;
       kmb_xlink_tj {
         status = "okay";
         compatible = "intel_tsens";
         local-host = <0x3>;
         remote-host = <0x3>;
         bus = <0x1>;
      };
    };
```

## Documentation/devicetree/bindings/misc/intel,intel-tsens.txt
```
Intel Temperature sensors in Bay series
---------------------

The tsens driver enables reading of onchip sensors present
in the Intel Bay SoC.

Required properties:
- compatible : "intel,intel-tsens"

- reg: list of register areas, as specified in reg-names
- interrupts: not used
- clocks: clock needed for thermal to operate

Example:
		tsens: tsens@20260000 {
			compatible = "intel,intel-tsens";
			status = "disabled";
			plat_name = "intel,keembay_thermal";
			reg = <0x0 0x20260000 0x0 0x100>;
			interrupts = <GIC_SPI 90 IRQ_TYPE_LEVEL_HIGH>;
			clocks = <&scmi_clk MOVISOC_KMB_A53_AUX_TSENS>;
			clk-rate = <1250000>;

			mss {
				passive_delay = <1000>;
				polling_delay = <2000>;
				trip_temp = <40000 80000 1000000>;
				trip_type = "passive", "passive", "critical";
			};

			css {
				passive_delay = <1000>;
				polling_delay = <2000>;
				trip_temp = <40000 80000 1000000>;
				trip_type = "passive", "passive", "critical";
			};

			nce {
				passive_delay = <1000>;
				polling_delay = <2000>;
				trip_temp = <40000 80000 1000000>;
				trip_type = "passive", "passive", "critical";
			};

			soc {
				passive_delay = <1000>;
				polling_delay = <2000>;
				trip_temp = <40000 80000 1000000>;
				trip_type = "passive", "passive", "critical";
			};
		};
```
