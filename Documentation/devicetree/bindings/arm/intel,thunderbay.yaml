## Documentation/devicetree/bindings/misc/intel,intel-tsens.yaml
```yaml
# SPDX-License-Identifier: (GPL-2.0-only OR BSD-2-Clause)
%YAML 1.2
---
$id: "http://devicetree.org/schemas/misc/intel,intel_tsens.yaml#"
$schema: "http://devicetree.org/meta-schemas/core.yaml#"

title: Intel Temperature sensors in Bay series

maintainers:
  - Udhayakumar C <udhayakumar.c@intel.com>

description: |
  The tsens driver enables reading of onchip sensors present
  in the Intel Bay SoC.
  Each subnode of the tsens represents sensors available
  on the soc.

select: false

properties:
  compatible:
    items:
      - const: intel,intel-tsens

  plat_name:
    contains:
      enum:
        - intel,keembay_thermal

  reg:
    minItems: 1
    maxItems: 2

  clocks:
    items:
      - description: thermal sensor clock

  clk-rate:
    minItems: 1
    maxItems: 1
    additionalItems: false
    items:
      - description: thermal sensor clock freq

  sensor_name:
    type: object
    description:
      Details to configure sensor trip points and its types.

    properties:
      passive_delay:
        minItems: 1
        maxItems: 1
        description: number of milliseconds to wait between polls when
                     performing passive cooling

      polling_delay:
        minItems: 1
        maxItems: 1
        description: number of milliseconds to wait between polls when checking
                     whether trip points have been crossed (0 for interrupt
                     driven systems)

      trip_temp:
        minItems: 1
        description: temperature for trip points

      trip_type:
        minItems: 1
        description: trip type list for trip points

    required:
      - passive_delay
      - polling_delay
      - trip_temp
      - trip_type

required:
  - compatible

additionalProperties: false

examples:
  - |
    tsens: tsens@20260000 {
        compatible = "intel,intel-tsens";
        status = "disabled";
        #address-cells = <2>;
        #size-cells = <2>;
        plat_name = "intel,keembay_thermal";
        reg = <0x0 0x20260000 0x0 0x100>;
        clocks = <&scmi_clk>;
        clk-rate = <1250000>;

        mss {
                passive_delay = <1000>;
                polling_delay = <2000>;
                trip_temp = <40000 80000 1000000>;
                trip_type = "passive", "passive", "critical";
        };

        css {
                passive_delay = <1000>;
                polling_delay = <2000>;
                trip_temp = <40000 80000 1000000>;
                trip_type = "passive", "passive", "critical";
        };

        nce {
                passive_delay = <1000>;
                polling_delay = <2000>;
                trip_temp = <40000 80000 1000000>;
                trip_type = "passive", "passive", "critical";
        };

        soc {
                passive_delay = <1000>;
                polling_delay = <2000>;
                trip_temp = <40000 80000 1000000>;
                trip_type = "passive", "passive", "critical";
        };
     };
```

## Documentation/devicetree/bindings/misc/intel,keembay-thermal.txt
```
Intel Keem Bay Thermal
---------------------

The Keem Bay Thermal driver enables reading of onchip sensors present
in the Intel Keem Bay SoC.

Required properties:
- compatible : "intel,keembay-tsens"
- compatible : "intel,keembay-dummy"

- reg: list of register areas, as specified in reg-names
- interrupts: not used
- clocks: clock needed for thermal to operate

Example:
		thermal@20260030 {
			compatible = "intel,keembay-tsens";
			reg = <0x0 0x20260030 0x0 0x20>;
			interrupts = <0x0 0x5a 0x4>;
			clocks = <0x6 0x21>;
			status = "okay";
		};
```

## Documentation/devicetree/bindings/misc/intel,keembay-vpu-mgr.yaml
```yaml
# SPDX-License-Identifier: GPL-2.0-only OR BSD-2-Clause
# Copyright (C) 2020 Intel
%YAML 1.2
---
$id: http://devicetree.org/schemas/misc/intel,keembay-vpu-mgr.yaml#
$schema: http://devicetree.org/meta-schemas/core.yaml#

title: Intel VPU manager bindings

maintainers:
  - Li, Tingqian <tingqian.li@intel.com>
  - Zhou, Luwei <luwei.zhou@intel.com>

description: |
  The Intel VPU manager provides shared memory and process
  depedent context management for Intel VPU hardware IP.

properties:
  compatible:
    items:
      - enum:
        - intel,keembay-vpu-mgr
        - intel,keembay-vpusmm

  memory-region:
    description:
      phandle to a node describing reserved memory (System RAM memory)
      used by VPU (see bindings/reserved-memory/reserved-memory.txt)
    maxItems: 1

  intel,keembay-vpu-ipc-id:
    $ref: /schemas/types.yaml#/definitions/uint32
    description:
      the index of the VPU slice to be managed. Default is 0.

required:
  - compatible
  - memory-region

additionalProperties: false

examples:
  - |
    vpumgr0 {
        compatible = "intel,keembay-vpu-mgr";
        memory-region = <&vpu_reserved>;
        intel,keembay-vpu-ipc-id = <0x0>;
    };
```

## Documentation/devicetree/bindings/misc/intel,keembay-xlink-ipc.yaml
```yaml
# SPDX-License-Identifier: (GPL-2.0 OR BSD-2-Clause)
# Copyright (c) Intel Corporation. All rights reserved.
%YAML 1.2
---
$id: "http://devicetree.org/schemas/misc/intel,keembay-xlink-ipc.yaml#"
$schema: "http://devicetree.org/meta-schemas/core.yaml#"

title: Intel Keem Bay xlink IPC

maintainers:
  - Kelly Seamus <seamus.kelly@intel.com>

description: |
  The Keem Bay xlink IPC driver enables the communication/control sub-system
  for internal IPC communications within the Intel Keem Bay SoC.

properties:
  compatible:
    oneOf:
      - items:
          - const: intel,keembay-xlink-ipc

  memory-region:
    items:
      - description: reference to the CSS xlink IPC reserved memory region.
      - description: reference to the MSS xlink IPC reserved memory region.

  intel,keembay-vpu-ipc-id:
    $ref: "/schemas/types.yaml#/definitions/uint32"
    description: The numeric ID identifying the VPU within the xLink stack.

  intel,keembay-vpu-ipc-name:
    $ref: "/schemas/types.yaml#/definitions/string"
    description: User-friendly name for the VPU within the xLink stack.

  intel,keembay-vpu-ipc:
    $ref: "/schemas/types.yaml#/definitions/phandle"
    description: reference to the corresponding intel,keembay-vpu-ipc node.

additionalProperties: False

examples:
  - |
    xlink-ipc {
        compatible = "intel,keembay-xlink-ipc";
        memory-region = <&css_xlink_reserved>,
                        <&mss_xlink_reserved>;
        intel,keembay-vpu-ipc-id = <0x0>;
        intel,keembay-vpu-ipc-name = "vpu-slice-0";
        intel,keembay-vpu-ipc = <&vpuipc>;
    };
```

## Documentation/devicetree/bindings/misc/intel,vpu-cooling-dev.yaml
```yaml
# SPDX-License-Identifier: (GPL-2.0-only OR BSD-2-Clause)
# Copyright (C) 2020 Intel Corporation
%YAML 1.2
---
$id: "http://devicetree.org/schemas/soc/intel/intel,vpu-cooling-dev.yaml#"
$schema: "http://devicetree.org/meta-schemas/core.yaml#"

title: Movidius VPU Cooling Device

maintainers:
  - Demakkanavar, Kenchappa <kenchappa.demakkanavar@intel.com>

description:
  Movidius VPU coooling driver is thermal cooling agent registered
  to thermal framework. This driver communicates with vpu to get/set
  power modes based on the thermal driver requested states.

properties:
  compatible:
    const: intel,vpu-cooling-dev

  intel,vpu-ipc-id:
    $ref: "/schemas/types.yaml#/definitions/uint32"
    description: The numeric ID identifying the VPU within the xLink stack.

  #cooling-cells:
    const: 2
	description: If used as a cooling device, must be <2>
    Also see:
    Documentation/devicetree/bindings/thermal/thermal-cooling-devices.yaml
    min and max states are derived from the speed-map of the fan..

required:
  - compatible
  - intel,vpu-ipc-id:
  - #cooling-cells

additionalProperties: false

examples:
  - |
    vpu-cooling-device {
        compatible = "intel,vpu-cooling-dev";
        intel,vpu-ipc-id = < 0x00 >;
        status = "okay";
        #cooling-cells = < 0x02 >;
    };
```

## Documentation/devicetree/bindings/pci/intel,keembay-pcie-ep.yaml
```yaml
# SPDX-License-Identifier: (GPL-2.0 OR BSD-2-Clause)
%YAML 1.2
---
$id: "http://devicetree.org/schemas/pci/intel,keembay-pcie-ep.yaml#"
$schema: "http://devicetree.org/meta-schemas/core.yaml#"

title: Intel Keem Bay PCIe EP controller

maintainers:
  - Wan Ahmad Zainie <wan.ahmad.zainie.wan.mohamad@intel.com>

properties:
  compatible:
      const: intel,keembay-pcie-ep

  reg:
    items:
      - description: DesignWare PCIe registers
      - description: PCIe configuration space
      - description: Keem Bay specific registers

  reg-names:
    items:
      - const: dbi
      - const: addr_space
      - const: apb

  interrupts:
    items:
      - description: PCIe interrupt
      - description: PCIe event interrupt
      - description: PCIe error interrupt
      - description: PCIe memory access interrupt

  interrupt-names:
    items:
      - const: intr
      - const: ev_intr
      - const: err_intr
      - const: mem_access_intr

  num-ib-windows:
    description: Number of inbound address translation windows
    $ref: /schemas/types.yaml#/definitions/uint32

  num-ob-windows:
    description: Number of outbound address translation windows
    $ref: /schemas/types.yaml#/definitions/uint32

  num-lanes:
    description: Number of lanes to use.
    $ref: /schemas/types.yaml#/definitions/uint32
    enum: [ 1, 2, 4, 8 ]

required:
  - compatible
  - reg
  - reg-names
  - interrupts
  - interrupt-names
  - num-ib-windows
  - num-ob-windows

additionalProperties: false

examples:
  - |
    #include <dt-bindings/interrupt-controller/arm-gic.h>
    #include <dt-bindings/interrupt-controller/irq.h>
  - |
    pcie-ep@37000000 {
          compatible = "intel,keembay-pcie-ep";
          reg = <0x37000000 0x00800000>,
                <0x36000000 0x01000000>,
                <0x37800000 0x00000200>;
          reg-names = "dbi", "addr_space", "apb";
          interrupts = <GIC_SPI 107 IRQ_TYPE_LEVEL_HIGH>,
                       <GIC_SPI 108 IRQ_TYPE_EDGE_RISING>,
                       <GIC_SPI 109 IRQ_TYPE_LEVEL_HIGH>,
                       <GIC_SPI 110 IRQ_TYPE_LEVEL_HIGH>;
          interrupt-names = "intr", "ev_intr", "err_intr",
                       "mem_access_intr";
          num-ib-windows = <4>;
          num-ob-windows = <4>;
          num-lanes = <2>;
    };
```

## Documentation/devicetree/bindings/pci/intel,keembay-pcie.yaml
```yaml
# SPDX-License-Identifier: (GPL-2.0 OR BSD-2-Clause)
%YAML 1.2
---
$id: "http://devicetree.org/schemas/pci/intel,keembay-pcie.yaml#"
$schema: "http://devicetree.org/meta-schemas/core.yaml#"

title: Intel Keem Bay PCIe RC controller

maintainers:
  - Wan Ahmad Zainie <wan.ahmad.zainie.wan.mohamad@intel.com>

allOf:
  - $ref: /schemas/pci/pci-bus.yaml#

properties:
  compatible:
      const: intel,keembay-pcie

  reg:
    items:
      - description: DesignWare PCIe registers
      - description: PCIe configuration space
      - description: Keem Bay specific registers

  reg-names:
    items:
      - const: dbi
      - const: config
      - const: apb

  clocks:
    items:
      - description: bus clock
      - description: auxiliary clock

  clock-names:
    items:
      - const: master
      - const: aux

  interrupts:
    items:
      - description: PCIe interrupt
      - description: PCIe event interrupt
      - description: PCIe error interrupt
      - description: PCIe memory access interrupt

  interrupt-names:
    items:
      - const: intr
      - const: ev_intr
      - const: err_intr
      - const: mem_access_intr

  num-lanes:
    description: Number of lanes to use.
    $ref: /schemas/types.yaml#/definitions/uint32
    enum: [ 1, 2, 4, 8 ]

  num-viewport:
    description: Number of view ports configured in hardware.
    $ref: /schemas/types.yaml#/definitions/uint32
    default: 2

required:
  - compatible
  - reg
  - reg-names
  - clocks
  - clock-names
  - interrupts
  - interrupt-names

additionalProperties: false

examples:
  - |
    #include <dt-bindings/interrupt-controller/arm-gic.h>
    #include <dt-bindings/interrupt-controller/irq.h>
    #define KEEM_BAY_A53_PCIE
    #define KEEM_BAY_A53_AUX_PCIE
    pcie@37000000 {
          compatible = "intel,keembay-pcie";
          reg = <0x37000000 0x00800000>,
                <0x36e00000 0x00200000>,
                <0x37800000 0x00000200>;
          reg-names = "dbi", "config", "apb";
          #address-cells = <3>;
          #size-cells = <2>;
          device_type = "pci";
          ranges = <0x02000000 0 0x36000000 0x36000000 0 0x00e00000>;
          interrupts = <GIC_SPI 107 IRQ_TYPE_LEVEL_HIGH>,
                       <GIC_SPI 108 IRQ_TYPE_LEVEL_HIGH>,
                       <GIC_SPI 109 IRQ_TYPE_LEVEL_HIGH>,
                       <GIC_SPI 110 IRQ_TYPE_LEVEL_HIGH>;
          interrupt-names = "intr", "ev_intr", "err_intr",
                       "mem_access_intr";
          clocks = <&scmi_clk KEEM_BAY_A53_PCIE>,
                   <&scmi_clk KEEM_BAY_A53_AUX_PCIE>;
          clock-names = "master", "aux";
          num-viewport = <4>;
          num-lanes = <2>;
    };
```

## Documentation/devicetree/bindings/phy/intel,keembay-emmc-phy.yaml
```yaml
# SPDX-License-Identifier: (GPL-2.0 OR BSD-2-Clause)
%YAML 1.2
---
$id: "http://devicetree.org/schemas/phy/intel,keembay-emmc-phy.yaml#"
$schema: "http://devicetree.org/meta-schemas/core.yaml#"

title: Intel Keem Bay eMMC PHY bindings

maintainers:
  - Wan Ahmad Zainie <wan.ahmad.zainie.wan.mohamad@intel.com>

properties:
  compatible:
    const: intel,keembay-emmc-phy

  reg:
    maxItems: 1

  clocks:
    maxItems: 1

  clock-names:
    items:
      - const: emmcclk

  "#phy-cells":
    const: 0

required:
  - compatible
  - reg
  - "#phy-cells"

additionalProperties: false

examples:
  - |
    phy@20290000 {
          compatible = "intel,keembay-emmc-phy";
          reg = <0x20290000 0x54>;
          clocks = <&emmc>;
          clock-names = "emmcclk";
          #phy-cells = <0>;
    };
```
